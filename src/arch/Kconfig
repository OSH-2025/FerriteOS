## src/arch/Kconfig
```kconfig
# Copyright (c) Huawei Technologies Co., Ltd. 2019-2020. All rights reserved.

osource "arch/arm/Kconfig"
osource "arch/arm64/Kconfig"
osource "arch/xtensa/Kconfig"
osource "arch/riscv/Kconfig"
osource "arch/csky/Kconfig"

config LOSCFG_ARCH_FPU_ENABLE
    bool "Enable Floating Pointer Unit"
    default y
    depends on LOSCFG_ARCH_CORTEX_M4 || LOSCFG_ARCH_CORTEX_M7 || LOSCFG_ARCH_ARM_AARCH32 || \
    LOSCFG_ARCH_ARM_AARCH64 || LOSCFG_ARCH_RISCV_RV32IMC || LOSCFG_ARCH_XTENSA_LX6
    help
      This option will bypass floating procedure in system.

config LOSCFG_ARCH_SECURE_MONITOR_MODE
    bool "Run On Secure Monitor Mode"
    default n
    depends on LOSCFG_ARCH_ARM_AARCH64
    help
      This option will make the system run on EL3.

config LOSCFG_APC_ENABLE
    bool "Enable Access Permission Control"
    default y
    help
      This option will Enable Access Permission Control

config LOSCFG_FPB_ENABLE
    bool "Enable Flash Patch"
    default n
    depends on LOSCFG_ARCH_ARM_CORTEX_M || LOSCFG_ARCH_RISCV_RV32IMC
    help
      Answer Y to enable LiteOS to support Flash Patch

config RISCV_FPB_SET_PCO
    bool "Enable patch offset bigger than 1M"
    default y
    depends on LOSCFG_ARCH_RISCV && LOSCFG_FPB_ENABLE
    help
      Enable patch offset bigger than 1M by Set PCO(patch code branch offset) bit

config LOSCFG_LIB_CONFIGURABLE
    bool
    default n
    help
      Answer Y to enable LiteOS to support base kernel lib configurable

config LOSCFG_MULTI_BINARIES
    bool
    default n
    select LOSCFG_LIB_CONFIGURABLE
    help
      Answer Y to enable LiteOS to support multi binaries
```

## src/arch/csky/Kconfig
```kconfig
# Copyright (c) Huawei Technologies Co., Ltd. 2021-2021. All rights reserved.

config LOSCFG_ARCH_CSKY
    bool
    help
      This option will make the system run on csky architecture

config LOSCFG_ARCH_CSKY_V2
    bool
    select LOSCFG_ARCH_CSKY 
    help
      This option will make the system run on csky-v2 architecture

config LOSCFG_ARCH_CSKY_CK802
    bool
    select LOSCFG_ARCH_CSKY_V2

config LOSCFG_ARCH_CPU
    string
    default "ck802"  if LOSCFG_ARCH_CSKY_CK802

config LOSCFG_ARCH_CSKY_VER
    string
    default "ck802"  if LOSCFG_ARCH_CSKY_CK802
```

## src/arch/riscv/Kconfig
```kconfig
# RISC-V Architecture
config LOSCFG_ARCH_RISCV
    bool
    select LOSCFG_LIB_LIBC

config LOSCFG_ARCH_RISCV_RV32IMC
    bool
    select LOSCFG_ARCH_RISCV
    help
      32-bit RISCV architecture implementations.

config LOSCFG_ARCH_RISCV_RV32F
    bool
    help
      32-bit RISCV FPU architecture implementations.
```

## src/arch/xtensa/Kconfig
```kconfig
# Copyright (c) Huawei Technologies Co., Ltd. 2020-2020. All rights reserved.

# XTENSA Architecture

config LOSCFG_ARCH_XTENSA
    bool

#
# XTENSA support 32-bit(Aarch32)
#
config LOSCFG_ARCH_XTENSA_ARCH32
    bool
    select LOSCFG_ARCH_XTENSA
    help
      32-bit XTENSA architecture implementations

config LOSCFG_ARCH_XTENSA_LX6
    bool
    select LOSCFG_LIB_LIBC
    select LOSCFG_ARCH_XTENSA_ARCH32

config LOSCFG_ARCH_XTENSA_L106
    bool
    select LOSCFG_LIB_LIBC
    select LOSCFG_ARCH_XTENSA_ARCH32

config LOSCFG_ARCH_XTENSA_XEA2
    bool
    select LOSCFG_ARCH_XTENSA
    select LOSCFG_ARCH_XTENSA_ARCH32

config LOSCFG_ARCH_XTENSA_XEA3
    bool
    select LOSCFG_ARCH_XTENSA

config LOSCFG_ARCH_CPU
    string
    default "xtensa-lx6"  if LOSCFG_ARCH_XTENSA_LX6
    default "xtensa-l106" if LOSCFG_ARCH_XTENSA_L106
    default "xtensa-xea2" if LOSCFG_ARCH_XTENSA_XEA2
    default "xtensa-xea3" if LOSCFG_ARCH_XTENSA_XEA3

config LOSCFG_XTENSA_HIFI3Z
    bool
    select LOSCFG_ARCH_XTENSA_XEA2

config LOSCFG_HUAWEI_VISIONQ6_V3
    bool
    select LOSCFG_ARCH_XTENSA_XEA3
```

## src/compat/cmsis/Kconfig
```kconfig
config  LOSCFG_COMPAT_CMSIS
    bool "Enable Cmsis"
    default y
    select LOSCFG_KERNEL_MEMBOX if CMSIS_OS_VER = 1
    help
      Answer Y to enable LiteOS support cmsis interface.

if LOSCFG_COMPAT_CMSIS

config CMSIS_OS_VER
    int "Cmsis Api Version"
    default 2
    help
      The Cmsis Version Only Support 1 or 2.

endif # LOSCFG_COMPAT_CMSIS
```

## src/components/Kconfig
```kconfig
menu "Components"

source "components/ai/Kconfig"
source "components/net/Kconfig"
source "components/connectivity/Kconfig"
source "components/fs/Kconfig"
source "components/gui/Kconfig"
source "components/language/Kconfig"
source "components/lib/Kconfig"
source "components/media/Kconfig"
source "components/ota/Kconfig"
source "components/security/Kconfig"
source "components/sensorhub/Kconfig"
source "components/utility/Kconfig"
source "components/bootloader/Kconfig"

endmenu
```

## src/components/bootloader/Kconfig
```kconfig
menu "Bootloader"

config LOSCFG_BOOTLOADER
    bool "Enable BootLoader"
    default n
    help
      Answer y to enable bootloader.

endmenu
```

## src/components/connectivity/Kconfig
```kconfig
menu "Connectivity"

source "components/connectivity/mqtt/Kconfig"
source "components/connectivity/lwm2m/Kconfig"
source "components/connectivity/agent_tiny/Kconfig"
source "components/connectivity/nb_iot/Kconfig"
source "components/connectivity/atiny_log/Kconfig"

endmenu
```

## src/components/connectivity/agent_tiny/Kconfig
```kconfig
config LOSCFG_COMPONENTS_CONNECTIVITY_AGENTTINY
    bool

config LOSCFG_COMPONENTS_ATINY_MQTT
    bool "Enable Agenttiny Mqtt"
    select LOSCFG_COMPONENTS_CONNECTIVITY_AGENTTINY
    select LOSCFG_COMPONENTS_CONNECTIVITY_MQTT
    select LOSCFG_COMPONENTS_SECURITY_MBEDTLS
    default n
    help
      Answer y to enable agent tiny mqtt.

config LOSCFG_COMPONENTS_ATINY_LWM2M
    bool "Enable Agenttiny Lwm2m"
    select LOSCFG_COMPONENTS_FS_VFS
    select LOSCFG_COMPONENTS_CONNECTIVITY_AGENTTINY
    select LOSCFG_COMPONENTS_CONNECTIVITY_LWM2M
    select LOSCFG_COMPONENTS_SECURITY_MBEDTLS
    default n
    help
      Answer y to enable agent tiny lwm2m.
```

## src/components/connectivity/atiny_log/Kconfig
```kconfig
config LOSCFG_COMPONENTS_ATINY_LOG
    bool "Enable Atiny Log"
    default y
    help
      Answer y to enable agent tiny log.
```

## src/components/connectivity/lwm2m/Kconfig
```kconfig
config LOSCFG_COMPONENTS_CONNECTIVITY_LWM2M
    bool "Enable Lwm2m"
    default n
    help
      Answer y to enable lwm2m.
```

## src/components/connectivity/mqtt/Kconfig
```kconfig
config LOSCFG_COMPONENTS_CONNECTIVITY_MQTT
    bool "Enable Mqtt"
    default n
    help
        Answer y to enable mqtt.
```

## src/components/connectivity/nb_iot/Kconfig
```kconfig
config LOSCFG_COMPONENTS_CONNECTIVITY_NB_IOT
    bool "Enable NB IoT"
    select LOSCFG_COMPONENTS_NET_AT
    default n
    help
      Answer y to enable nb iot.

choice
    prompt "Choose AT Device"
    default LOSCFG_AT_DEVICE_BC95
    depends on LOSCFG_COMPONENTS_CONNECTIVITY_NB_IOT

    config LOSCFG_AT_DEVICE_BC95
    select LOSCFG_COMPONENTS_NET_AT_BC95
    bool "Enable bc95"

    config LOSCFG_AT_DEVICE_BG36
    select LOSCFG_COMPONENTS_NET_AT_BG36
    bool "Enable bg36"
endchoice
```

## src/components/fs/Kconfig
```kconfig
menu "FileSystem"

config LOSCFG_COMPONENTS_FS_FATFS
    bool "Enable FATFS"
    default n
    select LOSCFG_COMPONENTS_FS_VFS
    help
      Answer y to enable LiteOS support fat filesystem.

choice
    prompt "Choose Peripheral Driver"
    default LOSCFG_FATFS_USE_SD_CARD
    depends on LOSCFG_COMPONENTS_FS_FATFS

    config LOSCFG_FATFS_USE_SD_CARD
        bool "SD Card"
        depends on LOSCFG_HW_SD_CARD

    config LOSCFG_FATFS_USE_SPI_FLASH
        bool "SPI Flash"
        depends on LOSCFG_HW_SPI_FLASH
      
endchoice

config LOSCFG_COMPONENTS_FS_LITTLEFS
    bool "Enable LITTLEFS"
    default n
    select LOSCFG_COMPONENTS_FS_VFS
    help
      Answer y to enable littlefs filesystem.

config LOSCFG_COMPONENTS_FS_RAMFS
    bool "Enable RAMFS"
    default n
    select LOSCFG_COMPONENTS_FS_VFS
    help
      Answer y to enable LiteOS support ram filesystem.

config LOSCFG_COMPONENTS_FS_SPIFFS
    bool "Enable SPIFFS"
    default n
    select LOSCFG_COMPONENTS_FS_VFS
    help
      Answer y to enable LiteOS support spi flash filesystem.

config LOSCFG_COMPONENTS_FS_VFS
    bool
    select LOSCFG_COMPONENTS_FS

config LOSCFG_COMPONENTS_FS
    bool

endmenu
```

## src/components/gui/Kconfig
```kconfig
menu "Graphical User Interface"

config LOSCFG_COMPONENTS_GUI
    bool "Enable Gui"
    default n
    depends on LOSCFG_PLATFORM_STM32F769IDISCOVERY
    help
      Answer y to enable Graphical User Interface.

endmenu
```

## src/components/language/Kconfig
```kconfig
menu "Language"

source "components/language/jerryscript/Kconfig"
source "components/language/lua/Kconfig"
source "components/language/micropython/Kconfig"

endmenu
```

## src/components/language/jerryscript/Kconfig
```kconfig
config LOSCFG_COMPONENTS_JERRYSCRIPT
    bool "Enable Jerryscript"
    select LOSCFG_COMPONENTS_FS_VFS
    default n
    help
      Answer y to enable Jerryscript.

config JERRY_GLOBAL_HEAP_SIZE
    int "Jerryscript Head Size"
    depends on LOSCFG_COMPONENTS_JERRYSCRIPT
    default 10
    help
      Heap size occupied by jerryscript runtime.
```

## src/components/language/lua/Kconfig
```kconfig
config LOSCFG_COMPONENTS_LUA
    bool "Enable Lua"
    default n
    select LOSCFG_COMPONENTS_FS_VFS
    help
      Answer y to enable lua.
```

## src/components/language/micropython/Kconfig
```kconfig
config LOSCFG_COMPONENTS_MICROPYTHON
    bool "Enable Micropython"
    select LOSCFG_COMPONENTS_FS_VFS
    default n
    help
      Answer y to enable micropython.

config LOSCFG_MICROPYTHON_HEAD_SIZE
    int "Micropython Head Size"
    depends on LOSCFG_COMPONENTS_MICROPYTHON
    default 4096
    help
      Heap size occupied by python runtime.
```

## src/components/media/Kconfig
```kconfig
menu "Media"

source "components/media/libpng/Kconfig"
source "components/media/openexif/Kconfig"
source "components/media/opus/Kconfig"
source "components/media/pixman/Kconfig"
source "components/media/upnp/Kconfig"
source "components/media/tjpgdec/Kconfig"

endmenu
```

## src/components/media/libpng/Kconfig
```kconfig
config LOSCFG_COMPONENTS_LIBPNG
    bool "Enable libPng"
    default n
    help
      Answer y to enable libpng.
```

## src/components/media/openexif/Kconfig
```kconfig
config LOSCFG_COMPONENTS_OPENEXIF
    bool "Enable Openexif"
    default n
    help
      Answer y to enable openexif.
```

## src/components/media/opus/Kconfig
```kconfig
config LOSCFG_COMPONENTS_OPUS
    bool "Enable Opus"
    default n
    select LOSCFG_COMPONENTS_FS_VFS
    help
      Answer y to enable opus.
```

## src/components/media/pixman/Kconfig
```kconfig
config LOSCFG_COMPONENTS_PIXMAN
    bool "Enable Pixman"
    select LOSCFG_COMPONENTS_LIBPNG
    default n
    help
      Answer y to enable pixman.
```

## src/components/media/tjpgdec/Kconfig
```kconfig
config LOSCFG_COMPONENTS_TJPGDEC
    bool "Enable Tjpgdec"
    default n
    help
      Answer y to enable tjpgdec.
```
