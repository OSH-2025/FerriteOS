## src/components/media/upnp/Kconfig
```kconfig
config LOSCFG_COMPONENTS_UPNP
    bool "Enable Upnp"
    default n
    help
      Answer y to enable upnp.
```

## src/components/net/Kconfig
```kconfig
config LOSCFG_COMPONENTS_NETWORK
    bool

menu "Network"

osource "components/net/lwip/Kconfig"
osource "components/net/ifconfig/Kconfig"
osource "components/net/ping/Kconfig"
osource "components/net/net_at/Kconfig"
osource "components/net/sal/Kconfig"
osource "components/net/pcap/Kconfig"
osource "components/net/los_iperf/Kconfig"
osource "components/net/tftp_server/Kconfig"
osource "components/net/librws/Kconfig"
osource "components/net/http_parser/Kconfig"

endmenu
```

## src/components/net/http_parser/Kconfig
```kconfig
config LOSCFG_COMPONENTS_HTTP_PARSER
    bool "Enable Http Parser"
    select LOSCFG_COMPONENTS_NETWORK
    default n
    help
      Answer y to enable http parser.
```

## src/components/net/ifconfig/Kconfig
```kconfig
config LOSCFG_COMPONENTS_NET_IFCONFIG
    bool "Enable Ifconfig"
    select LOSCFG_COMPONENTS_NET_LWIP
    default n
    help
        Answer y to enable ifconfig.
```

## src/components/net/librws/Kconfig
```kconfig
config LOSCFG_COMPONENTS_LIBRWS
    bool "Enable Librws"
    select LOSCFG_COMPONENTS_NET_LWIP
    select LOSCFG_COMPONENTS_FS_VFS
    default n
    help
    Answer y to enable librws.
```

## src/components/net/los_iperf/Kconfig
```kconfig
config LOSCFG_COMPONENTS_IPERF
    bool "Enable Iperf"
    select LOSCFG_SHELL
    select LOSCFG_COMPONENTS_NET_LWIP
    default n
    help
      Answer y to enable iperf.

config LOSCFG_NET_IPERF_JITTER
    bool "Enable Udp jitter"
    depends on LOSCFG_COMPONENTS_IPERF
    default n
    help
      Answer y to enable jitter statistics.
```

## src/components/net/lwip/Kconfig
```kconfig
config LOSCFG_COMPONENTS_NET_LWIP
    bool "Enable Lwip"
    select LOSCFG_COMPONENTS_FS_VFS
    select LOSCFG_COMPONENTS_NETWORK
    select LOSCFG_COMPONENTS_NET_SAL
    default n
    help
      Answer y to enable lwip.

config LOSCFG_COMPONENTS_LWIP_DHCP
    bool "Enable DHCP"
    depends on LOSCFG_COMPONENTS_NET_LWIP
    default y
    help
      Answer y to enable lwip dhcp.

choice
    prompt "Enable Ipv4 Or Ipv6 Or NIP"
    default LOSCFG_LWIP_IPV4
    depends on LOSCFG_COMPONENTS_NET_LWIP

config LOSCFG_LWIP_IPV4
    bool "Enable Ipv4"

config LOSCFG_LWIP_IPV6
    bool "Enable Ipv6"

config LOSCFG_LWIP_NIP
    bool "Enable NIP"
	
endchoice
```

## src/components/net/net_at/Kconfig
```kconfig
config LOSCFG_COMPONENTS_NET_AT
    bool "Enable Net AT"
    select LOSCFG_COMPONENTS_NETWORK
    default n
    help
      Answer y to enable net AT.

config LOSCFG_COMPONENTS_NET_AT_INFO
    bool "Enable AT INFO"
    depends on LOSCFG_COMPONENTS_NET_AT
    default n

config LOSCFG_COMPONENTS_NET_AT_DEBUG
    bool "Enable AT DEBUG"
    depends on LOSCFG_COMPONENTS_NET_AT
    default n

choice
    prompt "Choose AT Device"
    default LOSCFG_COMPONENTS_NET_AT_ESP8266
    depends on LOSCFG_COMPONENTS_NET_AT

    config LOSCFG_COMPONENTS_NET_AT_ESP8266
    depends on LOSCFG_COMPONENTS_NET_AT
    bool "Enable esp8266"

    config LOSCFG_COMPONENTS_NET_AT_SIM900A
    depends on LOSCFG_COMPONENTS_NET_AT
    bool "Enable sim900a"

    config LOSCFG_COMPONENTS_NET_AT_BC95
    depends on LOSCFG_COMPONENTS_NET_AT
    depends on LOSCFG_COMPONENTS_CONNECTIVITY_NB_IOT
    bool "Enable bc95"

    config LOSCFG_COMPONENTS_NET_AT_BG36
    depends on LOSCFG_COMPONENTS_NET_AT
    depends on LOSCFG_COMPONENTS_CONNECTIVITY_NB_IOT
    bool "Enable bg36"

endchoice
```

## src/components/net/pcap/Kconfig
```kconfig
config LOSCFG_COMPONENTS_PCAP
    bool "Enable Pcap"
    select LOSCFG_COMPONENTS_NET_LWIP
    select LOSCFG_PF_PACKET_SOCKET
    select LOSCFG_COMPONENTS_FS_FATFS
    select LOSCFG_COMPONENTS_NET_IFCONFIG
    default n
    help
    Answer y to enable pcap.

config LOSCFG_PF_PACKET_SOCKET
    bool
```

## src/components/net/ping/Kconfig
```kconfig
config LOSCFG_COMPONENTS_NET_PING
    bool "Enable Ping"
    select LOSCFG_COMPONENTS_NET_LWIP
    default n
    help
        Answer y to enable ping.
```

## src/components/net/sal/Kconfig
```kconfig
config LOSCFG_COMPONENTS_NET_SAL
    bool "Enable Atiny Sal"
    default n
    help
      Answer y to enable atiny sal.

config LOSCFG_ATINY_SOCKET_DEBUG
    bool "Enable Atiny Socket Debug"
    default n
    depends on LOSCFG_COMPONENTS_NET_SAL
    help
      Answer y to enable atiny socket debug.
```

## src/components/net/tftp_server/Kconfig
```kconfig
config LOSCFG_COMPONENTS_TFTP_SERVER
    bool "Enable Tftp Server"
    select LOSCFG_COMPONENTS_NET_LWIP
    select LOSCFG_COMPONENTS_FS_FATFS
    default n
    help
    Answer y to enable tftp server.
```

## src/components/ota/Kconfig
```kconfig
menu "Device OTA"

config LOSCFG_COMPONENTS_OTA
    bool "Enable OTA"
    select LOSCFG_COMPONENTS_SECURITY
    select LOSCFG_DTLS_CRET_ENCRYPT
    select LOSCFG_COMPONENTS_SECURITY_MBEDTLS
    select LOSCFG_COMPONENTS_NETWORK
    select LOSCFG_COMPONENTS_NET_LWIP
    select LOSCFG_COMPONENTS_NET_SAL
    select LOSCFG_DTLS_CERT_ENCRYPT
    default n
    help
      Answer y to enable ota.

config LOSCFG_OTA_DEBUG
    bool "Enable OTA Debug"
    default n
    depends on LOSCFG_COMPONENTS_OTA
    help
      Answer y to enable ota debug.

endmenu
```

## src/components/security/Kconfig
```kconfig
menu "Security"

source "components/security/mbedtls/Kconfig"
source "components/security/openssl/Kconfig"
source "components/security/rhash/Kconfig"
source "components/security/tinycrypt/Kconfig"

endmenu
```

## src/components/security/mbedtls/Kconfig
```kconfig
config LOSCFG_COMPONENTS_SECURITY_MBEDTLS
    bool "Enable Mbedtls"
    default n
    help
      Answer y to enable mbedtls.
```

## src/components/security/openssl/Kconfig
```kconfig
config LOSCFG_COMPONENTS_OPENSSL
    bool "Enable Openssl"
    default n
    select LOSCFG_COMPONENTS_SECURITY
    help
      Answer y to enable openssl.
```

## src/components/security/rhash/Kconfig
```kconfig
config LOSCFG_COMPONENTS_RHASH
    bool "Enable RHash"
    default n
    select LOSCFG_COMPONENTS_SECURITY
    help
      Answer y to enable rhash.
```

## src/components/security/tinycrypt/Kconfig
```kconfig
config LOSCFG_COMPONENTS_TINYCRYPT
    bool "Enable Tinycrypt"
    default n
    select LOSCFG_COMPONENTS_SECURITY
    help
      Answer y to enable tinycrypt.
```

## src/components/utility/Kconfig
```kconfig
menu "Utility"

source "components/utility/apriltag/Kconfig"
source "components/utility/bidireference/Kconfig"
source "components/utility/c-algorithms/Kconfig"
source "components/utility/curl/Kconfig"
source "components/utility/easyflash/Kconfig"
source "components/utility/fastlz/Kconfig"
source "components/utility/freetype/Kconfig"
source "components/utility/genann/Kconfig"
source "components/utility/harfbuzz/Kconfig"
source "components/utility/iconv/Kconfig"
source "components/utility/inih/Kconfig"
source "components/utility/iniparser/Kconfig"
source "components/utility/jsmn/Kconfig"
source "components/utility/json-c/Kconfig"
source "components/utility/jsoncpp/Kconfig"
source "components/utility/libevent/Kconfig"
source "components/utility/libxml2/Kconfig"
source "components/utility/minmea/Kconfig"
source "components/utility/pdfgen/Kconfig"
source "components/utility/qrencode/Kconfig"
source "components/utility/regex/Kconfig"
source "components/utility/sfud/Kconfig"
source "components/utility/sqlite/Kconfig"
source "components/utility/thttpd/Kconfig"
source "components/utility/tinyframe/Kconfig"
source "components/utility/tinyxml2/Kconfig"
source "components/utility/uriparser/Kconfig"

endmenu
```

## src/components/utility/apriltag/Kconfig
```kconfig
config LOSCFG_EXTERNAL_MEM
    bool
    default n

config LOSCFG_COMPONENTS_APRILTAG
    select LOSCFG_COMPONENTS_FS_FATFS
    select LOSCFG_EXTERNAL_MEM
    bool "Enable Apriltag"
    default n
    help
      Answer y to enable apriltag.
```

## src/components/utility/bidireference/Kconfig
```kconfig
config LOSCFG_COMPONENTS_BIDIREFERENCE
    bool "Enable Bidireference"
    default n
    select LOSCFG_COMPONENTS_FS_VFS
    help
      Answer y to enable Bidireference.
```

## src/components/utility/c-algorithms/Kconfig
```kconfig
config LOSCFG_COMPONENTS_C_ALGORITHMS
    bool "Enable C-algorithms"
    default n
    help
      Answer y to enable c-algorithms.
```

## src/components/utility/curl/Kconfig
```kconfig
config LOSCFG_COMPONENTS_CURL
    bool "Enable Curl"
    select LOSCFG_COMPONENTS_NET_LWIP
    select LOSCFG_COMPONENTS_FS_FATFS
    default n
    help
      Answer y to enable curl.

config CURL_OPENSSL
    bool "Use Openssl"
    depends on LOSCFG_COMPONENTS_CURL
    select LOSCFG_COMPONENTS_OPENSSL
    default n
    help
        Answer y to enable use openssl.
```

## src/components/utility/easyflash/Kconfig
```kconfig
config LOSCFG_COMPONENTS_EASYFLASH
    bool "Enable Easyflash"
    select LOSCFG_COMPONENTS_SFUD
    default n
    help
      Answer y to enable easyflash.

config LOSCFG_EASYFLASH_DEBUG_MODE
    bool "Enable debug mode"
    default n
    depends on LOSCFG_COMPONENTS_EASYFLASH
    help
      Answer y to enable debug mode.

config LOSCFG_EASYFLASH_INFO_MODE
    bool "Enable info mode"
    default n
    depends on LOSCFG_COMPONENTS_EASYFLASH
    help
      Answer y to enable info mode.
```

## src/components/utility/fastlz/Kconfig
```kconfig
config LOSCFG_COMPONENTS_FASTLZ
    bool "Enable Fastlz"
    default n
    help
      Answer y to enable fastlz.
```
