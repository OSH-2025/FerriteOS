## src/components/utility/freetype/Kconfig
```kconfig
config LOSCFG_COMPONENTS_FREETYPE
    bool "Enable freetype"
    default n
    help
    Answer y to enable freetype.
```

## src/components/utility/genann/Kconfig
```kconfig
config LOSCFG_COMPONENTS_GENANN
    bool "Enable Genann"
    default n
    help
      Answer y to enable genann.
```

## src/components/utility/harfbuzz/Kconfig
```kconfig
config LOSCFG_COMPONENTS_HARFBUZZ
    bool "Enable Harfbuzz"
    default n
    select LOSCFG_COMPONENTS_FS_VFS
    select LOSCFG_COMPONENTS_FREETYPE
    help
      Answer y to enable harfbuzz.
```

## src/components/utility/iconv/Kconfig
```kconfig
config LOSCFG_COMPONENTS_ICONV
    bool "Enable Iconv"
    default n
    select LOSCFG_COMPONENTS_FS_VFS
    help
      Answer y to enable iconv.
```

## src/components/utility/inih/Kconfig
```kconfig
config LOSCFG_COMPONENTS_INIH
    bool "Enable Inih"
    default n
    help
      Answer y to enable inih.
```

## src/components/utility/iniparser/Kconfig
```kconfig
config LOSCFG_COMPONENTS_INIPARSER
    bool "Enable Iniparser"
    default n
    select LOSCFG_COMPONENTS_FS_VFS
    help
      Answer y to enable iniparser.
```

## src/components/utility/jsmn/Kconfig
```kconfig
config LOSCFG_COMPONENTS_JSMN
    bool "Enable Jsmn"
    default n
    help
      Answer y enable jsmn.
```

## src/components/utility/json-c/Kconfig
```kconfig
config LOSCFG_COMPONENTS_JSON_C
    bool "Enable Json-c"
    default n
    help
      Answer y enable json-c.
```

## src/components/utility/jsoncpp/Kconfig
```kconfig
config LOSCFG_COMPONENTS_JSONCPP
    bool "Enable Jsoncpp"
    default n
    help
      Answer y to enabl jsoncpp.
```

## src/components/utility/libevent/Kconfig
```kconfig
config LOSCFG_COMPONENTS_LIBEVENT
    bool "Enable Libevent"
    select LOSCFG_COMPONENTS_OPENSSL
    select LOSCFG_COMPONENTS_NET_LWIP
    default n
    help
      Answer y to enable libevent.
```

## src/components/utility/libxml2/Kconfig
```kconfig
config LOSCFG_COMPONENTS_LIBXML2
    bool "Enable Libxml2"
    default n
    help
      Answer y to enable libxml2.
```

## src/components/utility/minmea/Kconfig
```kconfig
config LOSCFG_COMPONENTS_MINMEA
    bool "Enable Minmea"
    default n
    help
      Answer y to enable minmea.
```

## src/components/utility/pdfgen/Kconfig
```kconfig
config LOSCFG_COMPONENTS_PDFGEN
    bool "Enable PDFGen"
    default n
    help
      Answer y to enable PDFGen.
```

## src/components/utility/qrencode/Kconfig
```kconfig
config LOSCFG_COMPONENTS_QRENCODE
    bool "Enable Qrencode"
    default n
    help
      Answer y to enable qrencode.
```

## src/components/utility/regex/Kconfig
```kconfig
config LOSCFG_COMPONENTS_REGEX
    bool "Enable Regex"
    default n
    help
      A small regex implementation in C.
```

## src/components/utility/sfud/Kconfig
```kconfig
config LOSCFG_COMPONENTS_SFUD
    bool "Enable Sfud"
    default n
    help
      Answer y to enable sfud.

config LOSCFG_SFUD_DEBUG_MODE
    bool "Enable debug mode"
    default n
    depends on LOSCFG_COMPONENTS_SFUD
    help
      Answer y to enable debug mode.

config LOSCFG_SFUD_USING_SFDP
    bool "Enable using sfdp"
    default n
    depends on LOSCFG_COMPONENTS_SFUD
    help
      Answer y to enable using sfdp.
config LOSCFG_SFUD_USING_FLASH_INFO_TABLE
    bool "Enable using flash info table"
    default n
    depends on LOSCFG_COMPONENTS_SFUD
    help
      Answer y to enable using flash info table.

config LOSCFG_SFUD_USING_QSPI
    bool "Enable using qspi"
    default n
    depends on LOSCFG_COMPONENTS_SFUD && LOSCFG_HW_QSPI
    help
      Answer y to enable using qspi.
```

## src/components/utility/sqlite/Kconfig
```kconfig
config LOSCFG_COMPONENTS_SQLITE
    bool "Enable Sqlite"
    default n
    help
      Answer y to enable sqlite.
```

## src/components/utility/thttpd/Kconfig
```kconfig
config LOSCFG_COMPONENTS_THTTPD
    bool "Enable Thttpd"
    default n
    select LOSCFG_COMPONENTS_FS_FATFS
    select LOSCFG_COMPONENTS_NET_LWIP
    help
      Answer y to enable thttpd.
```

## src/components/utility/tinyframe/Kconfig
```kconfig
config LOSCFG_COMPONENTS_TINYFRAME
    bool "Enable Tinyframe"
    default n
    help
      Answer y to enable tinyframe.
```

## src/components/utility/tinyxml2/Kconfig
```kconfig
config LOSCFG_COMPONENTS_TINYXML2
    bool "Enable Tinyxml2"
    default n
    help
      Answer y to enable tinyxml2.
```

## src/components/utility/uriparser/Kconfig
```kconfig
config LOSCFG_COMPONENTS_URIPARSER
    bool "Enable Uriparser"
    select LOSCFG_COMPONENTS_NET_LWIP
    default n
    help
      Answer y to enable uriparser.
```

## src/demos/agenttiny_lwm2m/Kconfig
```kconfig
menu "Agent Tiny Lwm2m Demo"

config LOSCFG_DEMOS_AGENT_TINY_LWM2M
    bool "Enable Agent Tiny Lwm2m Demo"
    select LOSCFG_COMPONENTS_CONNECTIVITY
    select LOSCFG_COMPONENTS_ATINY_LWM2M
    select LOSCFG_COMPONENTS_NET_LWIP
    default n
    help
      Answer y to enable agent tiny lwm2m demo.

endmenu
```

## src/demos/agenttiny_mqtt/Kconfig
```kconfig
menu "Agent Tiny Mqtt Demo"

config LOSCFG_DEMOS_AGENT_TINY_MQTT
    bool "Enable Agent Tiny Mqtt Demo"
    default n
    select LOSCFG_COMPONENTS_LIB_CJSON
    select LOSCFG_COMPONENTS_ATINY_MQTT
    help
      Answer y to enable agent tiny mqtt demo.

config LOSCFG_DTLS_MODE
    string
    default "NO_ENCRYPT"    if LOSCFG_DTLS_NO_ENCRYPT
    default "PSK_ENCRYPT"   if LOSCFG_DTLS_PSK_ENCRYPT
    default "CERT_ENCRYPT"  if LOSCFG_DTLS_CERT_ENCRYPT

choice
    prompt "encryption mode"
    depends on LOSCFG_DEMOS_AGENT_TINY_MQTT
    default LOSCFG_DTLS_NO_ENCRYPT
    help
      support encryption mode:
      NO_ENCRYPT
      PSK_ENCRYPT
      CERT_ENCRYPT

config LOSCFG_DTLS_NO_ENCRYPT
    bool "NO_ENCRYPT"

config LOSCFG_DTLS_PSK_ENCRYPT
    bool "PSK_ENCRYPT"
    select LOSCFG_COMPONENTS_SECURITY
    select LOSCFG_COMPONENTS_SECURITY_MBEDTLS

config LOSCFG_DTLS_CERT_ENCRYPT
    bool "CERT_ENCRYPT"
    select LOSCFG_COMPONENTS_SECURITY
    select LOSCFG_COMPONENTS_SECURITY_MBEDTLS

endchoice

endmenu
```

## src/demos/agriculture/Kconfig
```kconfig
menu "Agriculture Demo"

config LOSCFG_DEMOS_AGRICULTURE
    bool "Enable Agriculture Demo"
    depends on LOSCFG_DRIVER_E53
    default n
    help
      Answer y to enable agriculture demo.

endmenu
```
