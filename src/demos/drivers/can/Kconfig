## src/demos/drivers/can/Kconfig
```kconfig
config LOSCFG_DEMO_CAN
   bool "Enable Can Demo"
   default n
   help
     Answer y to run can demo.
```

## src/demos/dtls_server/Kconfig
```kconfig
menu "Dtls Server Demo"

config LOSCFG_DEMOS_DTLS_SERVER
    bool "Enable Dtls Server Demo"
    select LOSCFG_COMPONENTS_SECURITY
    select LOSCFG_COMPONENTS_SECURITY_MBEDTLS
    select LOSCFG_COMPONENTS_NETWORK
    select LOSCFG_COMPONENTS_NET_LWIP
    select LOSCFG_COMPONENTS_NET_SAL
    default n
    help
      Answer y to enable dtls server demo.

endmenu
```

## src/demos/fs/Kconfig
```kconfig
menu "FileSystem Demo"

config LOSCFG_DEMOS_FS_FAT
    bool "Enable Fat FileSystem Demo"
    default n
    select LOSCFG_COMPONENTS_FS_FATFS
    select LOSCFG_DEMOS_FS
    help
      Answer y to enable fat filesystem demo.

config LOSCFG_DEMOS_FS_LITTLEFS
    bool "Enable Littlefs FileSystem Demo"
    default n
    select LOSCFG_COMPONENTS_FS_LITTLEFS
    select LOSCFG_DEMOS_FS
    help
      Answer y to enable littlefs filesystem demo.

config LOSCFG_DEMOS_FS_RAM
    bool "Enable Ram FileSystem Demo"
    default n
    select LOSCFG_COMPONENTS_FS_RAMFS
    select LOSCFG_DEMOS_FS
    help
      Answer y to enable ram filesystem demo.

config LOSCFG_DEMOS_FS_SPIF
    bool "Enable Spi Flash FileSystem Demo"
    default n
    select LOSCFG_COMPONENTS_FS_SPIFFS
    select LOSCFG_DEMOS_FS
    help
      Answer y to enable spi flash filesystem demo.

config LOSCFG_DEMOS_FS
    bool

endmenu
```

## src/demos/gui/Kconfig
```kconfig
menu "Graphical User Interface Demo"

config LOSCFG_DEMOS_GUI
    bool "Enable Gui Demo"
    default n
    depends on LOSCFG_PLATFORM_STM32F769IDISCOVERY
    select LOSCFG_COMPONENTS_GUI
    select LOSCFG_GUI_ENABLE
    help
      Answer y to enable Graphical User Interface demo.

   config LOSCFG_GUI_ENABLE
   bool

endmenu
```

## src/demos/http_client/Kconfig
```kconfig
menu "Http Client Demo"

config LOSCFG_DEMOS_HTTP_CLIENT
    bool "Enable Http Client Demo"
    select LOSCFG_COMPONENTS_HTTP_PARSER
    select LOSCFG_COMPONENTS_NET_LWIP
    default n
    help
      Answer y to enable http client demo.

endmenu
```

## src/demos/kernel/Kconfig
```kconfig
menu "Kernel Demo"

config LOSCFG_DEMOS_KERNEL
    bool "Enable Kernel Demo"
    default n
    help
    Answer y to enable kernel demo.

config LOSCFG_DEMOS_KERNEL_SELECT
    depends on LOSCFG_DEMOS_KERNEL
    string
    default "DemoEntry"              if LOSCFG_DEMOS_KERNEL_ENTRY
    default "InspectEntry"           if LOSCFG_DEMOS_KERNEL_INSPECT_ENTRY

choice
    prompt "Kernel Demo Entry"
    depends on LOSCFG_DEMOS_KERNEL
    default LOSCFG_DEMOS_KERNEL_INSPECT_ENTRY
    help
      support entry:
      DemoEntry
      InspectEntry

config LOSCFG_DEMOS_KERNEL_INSPECT_ENTRY
    bool "InspectEntry"

config LOSCFG_DEMOS_KERNEL_ENTRY
    bool "DemoEntry"

config LOS_KERNEL_DEMO_TASK
    bool "Run Kernel Task Demo"
    depends on LOSCFG_DEMOS_KERNEL_ENTRY
    default n
    help
      Answer y to run kernel task demo.

config LOS_KERNEL_DEMO_MEM_DYNAMIC
    bool "Run Kernel Dynamic Mem Demo"
    depends on LOSCFG_DEMOS_KERNEL_ENTRY
    default n
    help
      Answer y to run kernel dynamic mem demo.

config LOS_KERNEL_DEMO_MEM_STATIC
    bool "Run Kernel Static Mem Demo"
    depends on LOSCFG_DEMOS_KERNEL_ENTRY
    default n
    help
      Answer y to run kernel mem_static demo.

config LOS_KERNEL_DEMO_INTERRUPT
    bool "Run Kernel Interrupt Demo"
    depends on LOSCFG_DEMOS_KERNEL_ENTRY
    default n
    help
      Answer y to run kernel interrupt demo.

config LOS_KERNEL_DEMO_QUEUE
    bool "Run Kernel Queue Demo"
    depends on LOSCFG_DEMOS_KERNEL_ENTRY
    default n
    help
      Answer y to run kernel queue demo.

config LOS_KERNEL_DEMO_EVENT
    bool "Run Kernel Event Demo"
    depends on LOSCFG_DEMOS_KERNEL_ENTRY
    default n
    help
      Answer y to run kernel event demo.

config LOS_KERNEL_DEMO_MUTEX
    bool "Run Kernel Mutex Demo"
    depends on LOSCFG_DEMOS_KERNEL_ENTRY
    default n
    help
      Answer y to run kernel mutex demo.

config LOS_KERNEL_DEMO_SEMPHORE
    bool "Run Kernel Semphore Demo"
    depends on LOSCFG_DEMOS_KERNEL_ENTRY
    default n
    help
      Answer y to run kernel semphore demo.

config LOS_KERNEL_DEMO_SYSTICK
    bool "Run Kernel Systick Demo"
    depends on LOSCFG_DEMOS_KERNEL_ENTRY
    default n
    help
      Answer y to run kernel systick demo.

config LOS_KERNEL_DEMO_SWTIMER
    bool "Run Kernel Software Timer Demo"
    depends on LOSCFG_DEMOS_KERNEL_ENTRY
    default n
    help
      Answer y to run kernel software timer demo.

config LOS_KERNEL_DEMO_LIST
    bool "Run Kernel List Demo"
    depends on LOSCFG_DEMOS_KERNEL_ENTRY
    default n
    help
      Answer y to run kernel list demo.

# test task
config LOS_KERNEL_DEBUG_TASK
    bool "Run Kernel Test Task Demo"
    depends on LOSCFG_DEMOS_KERNEL_ENTRY
    depends on LOSCFG_ARCH_CORTEX_A9
    default n
    help
      Answer y to run kernel task demo.

config LOS_KERNEL_TASK_CYCLE_TIMES
    int "Task Cycle Times"
    depends on LOS_KERNEL_DEBUG_TASK
    default 5

config LOS_KERNEL_TASK_NAME
    string "Task Name"
    depends on LOS_KERNEL_DEBUG_TASK
    default "task1"

config LOS_KERNEL_TASK_PRIORITY
    int "Task Priority"
    depends on LOS_KERNEL_DEBUG_TASK
    default 4

config LOS_KERNEL_TASK_STACKSIZE
    int "Task Stacksize"
    depends on LOS_KERNEL_DEBUG_TASK
    default 2048

config LOS_KERNEL_TASK_DELAYINTERVAL
    int "Task Delay Interval"
    depends on LOS_KERNEL_DEBUG_TASK
    default 1000

# test queue
config LOS_KERNEL_DEBUG_QUEUE
    bool "Run Kernel Test Queue Demo"
    depends on LOSCFG_DEMOS_KERNEL_ENTRY
    depends on LOSCFG_ARCH_CORTEX_A9
    default n
    help
      Answer y to run kernel queue demo.

config LOS_KERNEL_QUEUE_CYCLE_TIMES
    int "Queue Cycle Times"
    depends on LOS_KERNEL_DEBUG_QUEUE
    default 5

config LOS_KERNEL_QUEUE_SIZE
    int "Queue Size"
    depends on LOS_KERNEL_DEBUG_QUEUE
    default 10

config LOS_KERNEL_QUEUE_MESSAGELEN
    int "Queue Message Len"
    depends on LOS_KERNEL_DEBUG_QUEUE
    default 50

config LOS_KERNEL_QUEUE_MESSAGE
    string "Queue Message"
    depends on LOS_KERNEL_DEBUG_QUEUE
    default "message"

config LOS_KERNEL_QUEUE_SENDINTERVAL
    int "Queue Send Interval"
    depends on LOS_KERNEL_DEBUG_QUEUE
    default 1000

config LOS_KERNEL_QUEUE_RECEIVEINTERVAL
    int "Queue Receive Interval"
    depends on LOS_KERNEL_DEBUG_QUEUE
    default 1000

config LOS_KERNEL_QUEUE_OVERTIME
    int "Queue Timeout Interval"
    depends on LOS_KERNEL_DEBUG_QUEUE
    default 1000

# test event
config LOS_KERNEL_DEBUG_EVENT
    bool "Run Kernel Test Event Demo"
    depends on LOSCFG_DEMOS_KERNEL_ENTRY
    depends on LOSCFG_ARCH_CORTEX_A9
    default n
    help
      Answer y to run kernel event demo.

config LOS_KERNEL_EVENT_CYCLE_TIMES
    int "Event Cycle Times"
    depends on LOS_KERNEL_DEBUG_EVENT
    default 5

config LOS_KERNEL_EVENT_ID
    int "Event Id"
    depends on LOS_KERNEL_DEBUG_EVENT
    default 1

config LOS_KERNEL_EVENT_OVERTIME
    int "Event Receiving Timeout Interval"
    depends on LOS_KERNEL_DEBUG_EVENT
    default 0

# test mutex
config LOS_KERNEL_DEBUG_MUTEX
    bool "Run Kernel Test Mutex Demo"
    depends on LOSCFG_DEMOS_KERNEL_ENTRY
    depends on LOSCFG_ARCH_CORTEX_A9
    default n
    help
      Answer y to run kernel mutex demo.

config LOS_KERNEL_MUTEX_CYCLE_TIMES
    int "Mutex Cycle Times"
    depends on LOS_KERNEL_DEBUG_MUTEX
    default 5

config LOS_KERNEL_MUTEX_OVERTIME
    int "Mutex Timeout Interval"
    depends on LOS_KERNEL_DEBUG_MUTEX
    default 10000

# test semphore
config LOS_KERNEL_DEBUG_SEMPHORE
    bool "Run Kernel Test Semphore Demo"
    depends on LOSCFG_DEMOS_KERNEL_ENTRY
    depends on LOSCFG_ARCH_CORTEX_A9
    default n
    help
      Answer y to run kernel semphore demo.

config LOS_KERNEL_SEMPHORE_CYCLE_TIMES
    int "Semphore Cycle Times"
    depends on LOS_KERNEL_DEBUG_SEMPHORE
    default 5

config LOS_KERNEL_SEMPHORE_OVERTIME
    int "Semphore Timeout Interval"
    depends on LOS_KERNEL_DEBUG_SEMPHORE
    default 10000

endchoice

endmenu
```

## src/demos/language/Kconfig
```kconfig
menu "Language Demo"

source "demos/language/jerryscript/Kconfig"
source "demos/language/lua/Kconfig"

endmenu
```

## src/demos/language/jerryscript/Kconfig
```kconfig
config LOSCFG_DEMOS_JERRYSCRIPT
    bool "Enable Jerryscript Demo"
    select LOSCFG_COMPONENTS_JERRYSCRIPT
    default n
    help
      Answer y to enable jerryscript demo.
```

## src/demos/language/lua/Kconfig
```kconfig
config LOSCFG_DEMOS_LUA
    bool "Enable Lua Demo"
    default n
    select LOSCFG_COMPONENTS_LUA
    select LOSCFG_COMPONENTS_FS_RAMFS
    help
      Answer y to enable lua demo.
```

## src/demos/librws/Kconfig
```kconfig
menu "Librws Demo"

config LOSCFG_DEMOS_LIBRWS
    bool "Enable Librws Demo"
    select LOSCFG_COMPONENTS_LIBRWS
    default n
    help
      Answer y to enable librws demo.

endmenu
```

## src/demos/lms/Kconfig
```kconfig
menu "LMS Demo"

config LOSCFG_DEMOS_LMS
    bool "Enable LMS Demo"
    default n
    select LOSCFG_KERNEL_LMS
    help
      Answer y to enable LMS demo.

endmenu
```

## src/demos/media/Kconfig
```kconfig
menu "Media Demo"

source "demos/media/libpng/Kconfig"
source "demos/media/openexif/Kconfig"
source "demos/media/opus/Kconfig"
source "demos/media/pixman/Kconfig"
source "demos/media/upnp/Kconfig"
source "demos/media/tjpgdec/Kconfig"

endmenu
```

## src/demos/media/libpng/Kconfig
```kconfig
config LOSCFG_DEMOS_LIBPNG
    bool "Enable Libpng Demo"
    select LOSCFG_COMPONENTS_LIBPNG
    select LOSCFG_COMPONENTS_FS_FATFS
    default n
    help
      Answer y to enable libpng demo.
```

## src/demos/media/openexif/Kconfig
```kconfig
config LOSCFG_DEMOS_OPENEXIF
    bool "Enable Openexif Demo"
    select LOSCFG_COMPONENTS_OPENEXIF
    select LOSCFG_COMPONENTS_FS_FATFS
    default n
    help
      Answer y to enable openexif demo.
```

## src/demos/media/opus/Kconfig
```kconfig
config LOSCFG_DEMOS_OPUS
    bool "Enable Opus Demo"
    select LOSCFG_COMPONENTS_OPUS
    default n
    help
      Answer y to enable opus demo.
```

## src/demos/media/pixman/Kconfig
```kconfig
config LOSCFG_DEMOS_PIXMAN
    bool "Enable Pixman Demo"
    select LOSCFG_COMPONENTS_PIXMAN
    select LOSCFG_COMPONENTS_FS_FATFS
    default n
    help
      Answer y to enable pixman demo.
```

## src/demos/media/tjpgdec/Kconfig
```kconfig
config LOSCFG_DEMOS_TJPGDEC
    bool "Enable Tjpgdec Demo"
    select LOSCFG_COMPONENTS_TJPGDEC
    select LOSCFG_COMPONENTS_FS_FATFS
    default n
    help
      Answer y to enable tjpgdec demo.
```

## src/demos/media/upnp/Kconfig
```kconfig
config LOSCFG_DEMOS_UPNP
    bool "Enable Upnp Demo"
    select LOSCFG_COMPONENTS_UPNP
    default n
    help
      Answer y to enable upnp demo.
```

## src/demos/perf/Kconfig
```kconfig
menu "PERF Demo"

config LOSCFG_DEMOS_PERF
    bool "Enable PERF Demo"
    default n
    select LOSCFG_KERNEL_PERF
    help
      Answer y to enable perf demo.

endmenu
```

## src/demos/security/Kconfig
```kconfig
menu "Security Demo"

source "demos/security/openssl/Kconfig"
source "demos/security/rhash/Kconfig"
source "demos/security/tinycrypt/Kconfig"

endmenu
```

## src/demos/security/openssl/Kconfig
```kconfig
config LOSCFG_DEMOS_OPENSSL
    bool "Enable Openssl Demo"
    default n
    select LOSCFG_COMPONENTS_OPENSSL
    help
      Answer y to enable openssl demo.
```

## src/demos/security/rhash/Kconfig
```kconfig
config LOSCFG_DEMOS_RHASH
    bool "Enable RHash Demo"
    default n
    select LOSCFG_COMPONENTS_RHASH
    help
      Answer y to enable rhash demo.
```

## src/demos/security/tinycrypt/Kconfig
```kconfig
config LOSCFG_DEMOS_TINYCRYPT
    bool "Enable Tinycrypt Demo"
    default n
    select LOSCFG_COMPONENTS_TINYCRYPT
    help
      Answer y to enable tinycrypt demo.
```

## src/demos/sensorhub/Kconfig
```kconfig
menu "Sensorhub Demo"

comment "only support Cloud_STM32F429IGTx_FIRE"

config LOSCFG_DEMOS_SENSORHUB
    bool "Enable Sensorhub Demo"
    default n
    select LOSCFG_COMPONENTS_SENSORHUB
    help
      Answer y to enable sensorhub demo.

endmenu
```

## src/demos/trace/Kconfig
```kconfig
menu "Trace Demo"

config LOSCFG_DEMOS_TRACE
    bool "Enable Trace Demo"
    default n
    select LOSCFG_KERNEL_EXTKERNEL
    select LOSCFG_KERNEL_TRACE
    help
      Answer y to enable trace demo.

endmenu
```
