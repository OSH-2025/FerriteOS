## src/demos/utility/Kconfig
```kconfig
menu "Utility Demo"

source "demos/utility/apriltag/Kconfig"
source "demos/utility/bidireference/Kconfig"
source "demos/utility/c-algorithms/Kconfig"
source "demos/utility/curl/Kconfig"
source "demos/utility/easyflash/Kconfig"
source "demos/utility/fastlz/Kconfig"
source "demos/utility/freetype/Kconfig"
source "demos/utility/genann/Kconfig"
source "demos/utility/harfbuzz/Kconfig"
source "demos/utility/iconv/Kconfig"
source "demos/utility/inih/Kconfig"
source "demos/utility/iniparser/Kconfig"
source "demos/utility/jsmn/Kconfig"
source "demos/utility/json-c/Kconfig"
source "demos/utility/jsoncpp/Kconfig"
source "demos/utility/libevent/Kconfig"
source "demos/utility/libxml2/Kconfig"
source "demos/utility/minmea/Kconfig"
source "demos/utility/pdfgen/Kconfig"
source "demos/utility/qrencode/Kconfig"
source "demos/utility/sqlite/Kconfig"
source "demos/utility/tinyframe/Kconfig"
source "demos/utility/tinyxml2/Kconfig"
source "demos/utility/sfud/Kconfig"
source "demos/utility/uriparser/Kconfig"

endmenu
```

## src/demos/utility/apriltag/Kconfig
```kconfig
config LOSCFG_DEMOS_APRILTAG
    bool "Enable Apriltag Demo"
    select LOSCFG_COMPONENTS_APRILTAG
    depends on LOSCFG_PLATFORM_STM32F769IDISCOVERY
    default n
    help
      Answer y to enable apriltag demo.
```

## src/demos/utility/bidireference/Kconfig
```kconfig
config LOSCFG_DEMOS_BIDIREFERENCE
    bool "Enable Bidireference Demo"
    select LOSCFG_COMPONENTS_BIDIREFERENCE
    select LOSCFG_COMPONENTS_FS_RAMFS
    default n
    help
      Answer y to enable bidireference demo.
```

## src/demos/utility/c-algorithms/Kconfig
```kconfig
config LOSCFG_DEMOS_C_ALGORITHMS
    bool "Enable C-algorithms Demo"
    select LOSCFG_COMPONENTS_C_ALGORITHMS
    default n
    help
      Answer y to enable algorithms demo.
```

## src/demos/utility/curl/Kconfig
```kconfig
config LOSCFG_DEMOS_CURL
    bool "Enable Curl Demo"
    select LOSCFG_COMPONENTS_NET_LWIP
    select LOSCFG_COMPONENTS_FS_FATFS
    select LOSCFG_COMPONENTS_CURL
    default n
    help
      Answer y to enable curl demo.
```

## src/demos/utility/easyflash/Kconfig
```kconfig
config LOSCFG_DEMOS_EASYFLASH
    bool "Enable Easyflash Demo"
    select LOSCFG_COMPONENTS_EASYFLASH
    default n
    help
      Answer y to enable easyflash demo.
```

## src/demos/utility/fastlz/Kconfig
```kconfig
config LOSCFG_DEMOS_FASTLZ
    bool "Enable Fastlz Demo"
    select LOSCFG_COMPONENTS_FASTLZ
    select LOSCFG_COMPONENTS_FS_FATFS
    default n
    help
      Answer y to enable fastlz demo.
```

## src/demos/utility/freetype/Kconfig
```kconfig
config LOSCFG_DEMOS_FREETYPE
    bool "Enable FreeType Demo"
    select LOSCFG_COMPONENTS_FS_FATFS
    select LOSCFG_COMPONENTS_FREETYPE
    default n
    help
      Answer y to enable freetype demo.
```

## src/demos/utility/genann/Kconfig
```kconfig
config LOSCFG_DEMOS_GENANN
    bool "Enable Genann Demo"
    select LOSCFG_COMPONENTS_GENANN
    select LOSCFG_COMPONENTS_FS_VFS
    default n
    help
      Answer y to enable genann demo.
```

## src/demos/utility/harfbuzz/Kconfig
```kconfig
config LOSCFG_DEMOS_HARFBUZZ
    bool "Enable Harfbuzz Demo"
    select LOSCFG_COMPONENTS_HARFBUZZ
    default n
    help
      Answer y to enable harfbuzz demo.
```

## src/demos/utility/iconv/Kconfig
```kconfig
config LOSCFG_DEMOS_ICONV
    bool "Enable Iconv Demo"
    select LOSCFG_COMPONENTS_ICONV
    default n
    help
      Answer y to enable icon demo.
```

## src/demos/utility/inih/Kconfig
```kconfig
config LOSCFG_DEMOS_INIH
    bool "Enable Inih Demo"
    select LOSCFG_COMPONENTS_FS_RAMFS
    select LOSCFG_COMPONENTS_INIH
    default n
    help
      Answer y to enable inih demo.
```

## src/demos/utility/iniparser/Kconfig
```kconfig
config LOSCFG_DEMOS_INIPARSER
    bool "Enable Iniparser Demo"
    select LOSCFG_COMPONENTS_FS_RAMFS
    select LOSCFG_COMPONENTS_INIPARSER
    default n
    help
      Answer y to enable iniparser demo.
```

## src/demos/utility/jsmn/Kconfig
```kconfig
config LOSCFG_DEMOS_JSMN
    bool "Enable Jsmn Demo"
    select LOSCFG_COMPONENTS_JSMN
    select LOSCFG_COMPONENTS_FS_VFS
    default n
    help
      Answer y to enable jsmn demo.
```

## src/demos/utility/json-c/Kconfig
```kconfig
config LOSCFG_DEMOS_JSON_C
    bool "Enable Json-c Demo"
    select LOSCFG_COMPONENTS_JSON_C
    select LOSCFG_COMPONENTS_FS_VFS
    default n
    help
      Answer y to enable json demo.
```

## src/demos/utility/jsoncpp/Kconfig
```kconfig
config LOSCFG_DEMOS_JSONCPP
    bool "Enable Jsoncpp Demo"
    default n
    select LOSCFG_COMPONENTS_JSONCPP
    select LOSCFG_COMPONENTS_FS_VFS
    help
      Answer y to enable jsoncpp demo.
```

## src/demos/utility/libevent/Kconfig
```kconfig
config LOSCFG_DEMOS_LIBEVENT
    bool "Enable Libevent Demo"
    select LOSCFG_COMPONENTS_LIBEVENT
    default n
    help
      Answer y to enable libevent demo.
```

## src/demos/utility/libxml2/Kconfig
```kconfig
config LOSCFG_DEMOS_LIBXML2
    bool "Enable Libxml2 Demo"
    select LOSCFG_COMPONENTS_LIBXML2
    select LOSCFG_COMPONENTS_FS_FATFS
    default n
    help
      Answer y to enable libxml2 demo.
```

## src/demos/utility/minmea/Kconfig
```kconfig
config LOSCFG_DEMOS_MINMEA
    bool "Enable Minmea Demo"
    select LOSCFG_COMPONENTS_MINMEA
    default n
    help
      Answer y to enable minmea demo.
```

## src/demos/utility/pdfgen/Kconfig
```kconfig
config LOSCFG_DEMOS_PDFGEN
    bool "Enable PDFGen Demo"
    select LOSCFG_COMPONENTS_PDFGEN
    select LOSCFG_COMPONENTS_FS_FATFS
    default n
    help
      Answer y to enable PDFGen demo.
```

## src/demos/utility/qrencode/Kconfig
```kconfig
config LOSCFG_DEMOS_QRENCODE
    bool "Enable Qrencode Demo"
    select LOSCFG_COMPONENTS_QRENCODE
    select LOSCFG_COMPONENTS_FS_FATFS
    default n
    help
      Answer y to enable qrencode demo.
```

## src/demos/utility/sfud/Kconfig
```kconfig
config LOSCFG_DEMOS_SFUD
    bool "Enable Sfud Demo"
    select LOSCFG_COMPONENTS_SFUD
    default n
    help
      Answer y to enable sfud demo.
```

## src/demos/utility/sqlite/Kconfig
```kconfig
config LOSCFG_DEMOS_SQLITE
    bool "Enable Sqlite Demo"
    select LOSCFG_COMPONENTS_SQLITE
    select LOSCFG_COMPONENTS_FS_FATFS
    default n
    help
      Answer y to enable sqlite demo.
```

## src/demos/utility/tinyframe/Kconfig
```kconfig
config LOSCFG_DEMOS_TINYFRAME
    bool "Enable Tinyframe Demo"
    select LOSCFG_COMPONENTS_TINYFRAME
    default n
    help
      Answer y to enable tinyframe demo.
```

## src/demos/utility/tinyxml2/Kconfig
```kconfig
config LOSCFG_DEMOS_TINYXML2
    bool "Enable Tinyxml2 Demo"
    select LOSCFG_COMPONENTS_TINYXML2
    select LOSCFG_COMPONENTS_FS_RAMFS
    default n
    help
      Answer y to enable tinyxml2 demo.
```
