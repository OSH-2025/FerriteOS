## src/demos/utility/uriparser/Kconfig
```kconfig
config LOSCFG_DEMOS_URIPARSER
    bool "Enable Uriparser Demo"
    select LOSCFG_COMPONENTS_URIPARSER
    default n
    help
      Answer y to enable uriparser demo.
```

## src/drivers/Kconfig
```kconfig
menu "Driver"

osource "drivers/base/Kconfig"
osource "drivers/interrupt/Kconfig"
osource "drivers/timer/Kconfig"
osource "drivers/uart/Kconfig"

endmenu
```

## src/drivers/interrupt/Kconfig
```kconfig
config LOSCFG_ARM_GIC_V2
    bool
    help
      This GIC(General Interrupt Controller) version 2 driver is compatatble with
      GIC version 1 and version 2.

config LOSCFG_ARM_GIC_V3
    bool
    depends on LOSCFG_ARCH_ARM_V8A || LOSCFG_ARCH_ARM_V8R
    help
      General Interrupt Controller version 3.

config LOSCFG_CORTEX_M_NVIC
    bool
    help
      NVIC(Nested Vectored Interrupt Controller) for Cortex-M.

config LOSCFG_PLATFORM_BSP_XTENSA_XEA3
    bool
    help
      General Interrupt Controller xtensa xea3.

config LOSCFG_XEA2_INT_CONTROLLER
    bool
    help
      General Interrupt Controller xtensa xea2.

config LOSCFG_PLATFORM_BSP_RISCV_PLIC
    bool
    depends on LOSCFG_ARCH_RISCV
    help
      Riscv Platform Level Interrupt Controller

config LOSCFG_PLATFORM_BSP_VIC
    bool
    help
      VIC(Vectored Interrupt Controller) for C-SKY.

config LOSCFG_PLATFORM_BSP_RISCV_ECLIC
    bool
    depends on LOSCFG_ARCH_RISCV
    help
      GD32VF103 Riscv Platform Level Interrupt Controller

config LOSCFG_PLATFORM_ARM_CONTROL
    bool
    help
      Raspberry Pi 2B/3B Arm Interrupt control

config LOSCFG_LX6_INT_CONTROLLER
    bool
    help
      xtensa lx6 interrupt
```

## src/drivers/timer/Kconfig
```kconfig
config LOSCFG_ARM_GENERIC_TIMER
    bool
    help
      ARM generic timer.

config LOSCFG_ARM_PRIVATE_TIMER
    bool
    help
      ARM private timer.

config LOSCFG_CORTEX_M_SYSTICK
    bool
    help
      ARM cortex-m systick.

config LOSCFG_ARM_SP804_TIMER
    bool
    help
      ARM sp804 dual timer.

config LOSCFG_ARM_SP804_HRTIMER
    bool
    help
      ARM sp804 dual timer as hrtimer.

config LOSCFG_XTENSA_LX6_TIMER
    bool
    help
      Xtensa lx6 systick.

config LOSCFG_XTENSA_XEA2_TIMER
    bool
    help
      Xtensa xea2 systick.

config LOSCFG_XTENSA_XEA3_TIMER
    bool
    help
      Xtensa xea3 systick.

config LOSCFG_ARM_SP804_ADVANCED
    bool
    select LOSCFG_BASE_CORE_SWTMR
    help
      If enabled advanced driver of ARM sp804 timer.
      If enabled, then use a swtmr and an additional hardware timer to recording the system running period.

config LOSCFG_RISCV32_M_TIMER
    bool
    help
      RISCV32 machine timer.

config LOSCFG_CSKY_SYSTICK
    bool
    help
      CSKY systick.

config LOSCFG_RASPBERRY_PI_SYSTICK
    bool
    help
      Raspberry Pi2B Systick.
```

## src/drivers/uart/Kconfig
```kconfig
config LOSCFG_DRIVERS_UART_ARM_PL011
    bool

choice
    prompt "Enable Uart"
    default LOSCFG_DRIVERS_SIMPLE_UART

config LOSCFG_DRIVERS_SIMPLE_UART
    bool "Simple Uart"

endchoice
```

## src/rust/Kconfig
```kconfig
menu "Rust"
config LOSCFG_ENABLE_RUST
    bool "Enable Rust"
    default y
    help
        Enable the use of Rust in LiteOS.
endmenu
```

## src/shell/Kconfig
```kconfig
config LOSCFG_SHELL
    bool "Enable Shell"
    default n
    depends on LOSCFG_DEBUG_VERSION
    help
      Answer Y to enable LiteOS support shell cmd.

choice
    prompt "Select Shell Input"
    default LOSCFG_SHELL_UART
    depends on LOSCFG_SHELL
    help
      Select shell input, when the input source is chosen, the shell will read the
      terminal input from the source.

config LOSCFG_SHELL_UART
    bool "Uart"
    depends on LOSCFG_DRIVERS_SIMPLE_UART
    help
      The shell will directly interact with the uart drivers, and only one input
      source is supported.

endchoice

config LOSCFG_SHELL_EXTENDED_CMDS
    bool "Enable Shell Ext CMDs"
    default n
    depends on LOSCFG_DEBUG_VERSION && LOSCFG_SHELL
    select LOSCFG_COMPAT_POSIX
    help
      Answer Y to enable LiteOS support shell extened cmds.

config LOSCFG_SHELL_LK
    bool "Enable Shell LK"
    default y
    depends on LOSCFG_DEBUG_VERSION && LOSCFG_SHELL && LOSCFG_COMPONENTS_FS_VFS
    help
      Answer Y to enable LiteOS support shell lk.

config LOSCFG_SHELL_DMESG
    bool "Enable Shell DMESG"
    default n
    depends on LOSCFG_DEBUG_VERSION && LOSCFG_SHELL
    help
      Answer Y to enable LiteOS support shell dmesg.
```

## src/targets/Kconfig
```kconfig
choice
    prompt "Family"

config LOSCFG_FAMILY_APM32
    bool "APM32"

config LOSCFG_FAMILY_CSKY
    bool "CSKY"

config LOSCFG_FAMILY_FMSH
    bool "FMSH"

config LOSCFG_FAMILY_GD
    bool "GD"

config LOSCFG_FAMILY_QEMU
    bool "QEMU"

config LOSCFG_FAMILY_RASPBERRY
    bool "raspberry"

config LOSCFG_FAMILY_SIFIVE
    bool "SIFIVE"

config LOSCFG_FAMILY_STM32
    bool "STM32"

config LOSCFG_FAMILY_XTENSA
    bool "XTENSA"

endchoice

osource "targets/Kconfig.apm32"
osource "targets/Kconfig.csky"
osource "targets/Kconfig.fmsh"
osource "targets/Kconfig.gd"
osource "targets/Kconfig.qemu"
osource "targets/Kconfig.raspberry"
osource "targets/Kconfig.sifive"
osource "targets/Kconfig.stm32"
osource "targets/Kconfig.xtensa"

config LOSCFG_HW_SD_CARD
    bool

config LOSCFG_DRIVER_HAL_LIB
    bool

config LOSCFG_DRIVER_GD_LIB
    bool

config LOSCFG_DRIVER_CSKY_LIB
    bool

config LOSCFG_DRIVER_SIFIVE_LIB
    bool

config LOSCFG_DRIVER_APM_LIB
    bool

config LOSCFG_HW_SPI_FLASH
    bool

config LOSCFG_USING_BOARD_LD
    bool

config LOSCFG_HW_QSPI
    bool "Qspi peripherals"

config LOSCFG_DRIVER_E53
    bool
```

## src/targets/Kconfig.apm32
```kconfig
config LOSCFG_PLATFORM
    string
    default "APM32F103_Geehy"           	if LOSCFG_PLATFORM_APM32F103_GEEHY

choice
    prompt "Target"
    depends on LOSCFG_FAMILY_APM32
    default LOSCFG_PLATFORM_APM32F103_GEEHY
    help
      support several boards:
      APM32F103_Geehy

config LOSCFG_PLATFORM_APM32F103_GEEHY
    bool "APM32F103_Geehy"
    select LOSCFG_USING_BOARD_LD
    select LOSCFG_ARCH_CORTEX_M3
    select LOSCFG_CORTEX_M_NVIC
    select LOSCFG_CORTEX_M_SYSTICK
    select LOSCFG_DRIVER_APM_LIB

endchoice
```

## src/targets/Kconfig.csky
```kconfig
config LOSCFG_PLATFORM
    string
    default "CB2201"      if LOSCFG_PLATFORM_CB2201

choice
    prompt "Target"
    depends on LOSCFG_FAMILY_CSKY
    default LOSCFG_PLATFORM_CB2201
    help
      CB2201

config LOSCFG_PLATFORM_CB2201
    bool "CB2201"
    select LOSCFG_ARCH_CSKY_CK802
    select LOSCFG_PLATFORM_BSP_VIC
    select LOSCFG_CSKY_SYSTICK
    select LOSCFG_DRIVERS_UART_CSKY_PORT
    select LOSCFG_DRIVER_CSKY_LIB
    select LOSCFG_USING_BOARD_LD

endchoice
```

## src/targets/Kconfig.fmsh
```kconfig
config LOSCFG_PLATFORM
    string
    default "FM33LC0XX_DEMO"           	if LOSCFG_PLATFORM_FM33LC0XX_DEMO

choice
    prompt "Target"
    depends on LOSCFG_FAMILY_FMSH
    default LOSCFG_PLATFORM_FM33LC0XX_DEMO
    help
      support several boards:
      FM33LC0XX_DEMO

config LOSCFG_PLATFORM_FM33LC0XX_DEMO
    bool "FM33LC0XX_DEMO"
    select LOSCFG_USING_BOARD_LD
    select LOSCFG_ARCH_CORTEX_M0
    select LOSCFG_CORTEX_M_NVIC
    select LOSCFG_CORTEX_M_SYSTICK
    select LOSCFG_DRIVER_HAL_LIB

endchoice
```

## src/targets/Kconfig.gd
```kconfig
config LOSCFG_PLATFORM
    string
    default "GD32E103C_START"       if LOSCFG_PLATFORM_GD32E103C_START
    default "GD32F303RGT6_BearPi"   if LOSCFG_PLATFORM_GD32F303RGT6_BEARPI
    default "GD32VF103V_EVAL"       if LOSCFG_PLATFORM_GD32VF103V_EVAL

choice
    prompt "Target"
    depends on LOSCFG_FAMILY_GD
    default LOSCFG_PLATFORM_GD32E103C_START
    help
      GD32E103C_START
      GD32F303RGT6_BearPi
      GD32VF103V_EVAL

config LOSCFG_PLATFORM_GD32E103C_START
    bool "GD32E103C_START"
    select LOSCFG_USING_BOARD_LD
    select LOSCFG_ARCH_CORTEX_M4
    select LOSCFG_CORTEX_M_NVIC
    select LOSCFG_CORTEX_M_SYSTICK
    select LOSCFG_DRIVER_GD_LIB

config LOSCFG_PLATFORM_GD32F303RGT6_BEARPI
    bool "GD32F303RGT6_BearPi"
    select LOSCFG_USING_BOARD_LD
    select LOSCFG_ARCH_CORTEX_M4
    select LOSCFG_CORTEX_M_NVIC
    select LOSCFG_CORTEX_M_SYSTICK
    select LOSCFG_DRIVER_GD_LIB

config LOSCFG_PLATFORM_GD32VF103V_EVAL
    bool "GD32VF103V_EVAL"
    select LOSCFG_USING_BOARD_LD
    select LOSCFG_ARCH_RISCV_RV32IMC
    select LOSCFG_RISCV32_M_TIMER
    select LOSCFG_PLATFORM_BSP_RISCV_ECLIC
    select LOSCFG_DRIVER_GD_LIB

endchoice
```

## src/targets/Kconfig.qemu
```kconfig
config LOSCFG_PLATFORM
    string
    default "realview-pbx-a9" if LOSCFG_PLATFORM_PBX_A9
    default "qemu-virt-a53"   if LOSCFG_PLATFORM_QEMU_VIRT_A53
    default "SmartL_E802"     if LOSCFG_PLATFORM_SMARTL_E802
    default "ESP32"           if LOSCFG_PLATFORM_ESP32_QEMU

choice
    prompt "Target"
    depends on LOSCFG_FAMILY_QEMU
    default LOSCFG_PLATFORM_PBX_A9
    help
      qemu-virt-a53
      realview-pbx-a9
      SmartL_E802
      ESP32

config LOSCFG_PLATFORM_PBX_A9
    bool "realview-pbx-a9"
    select LOSCFG_ARCH_CORTEX_A9
    select LOSCFG_ARM_GIC_V2
    select LOSCFG_ARM_PRIVATE_TIMER
    select LOSCFG_DRIVERS_UART_ARM_PL011
    select LOSCFG_USING_BOARD_LD

config LOSCFG_PLATFORM_QEMU_VIRT_A53
    bool "qemu-virt-a53"
    select LOSCFG_ARCH_CORTEX_A53
    select LOSCFG_ARM_GIC_V2
    select LOSCFG_ARM_GENERIC_TIMER
    select LOSCFG_DRIVERS_UART_ARM_PL011
    select LOSCFG_ARCH_ARM_AARCH64
    select LOSCFG_USING_BOARD_LD

config LOSCFG_PLATFORM_SMARTL_E802
    bool "SmartL_E802"
    select LOSCFG_ARCH_CSKY_CK802
    select LOSCFG_PLATFORM_BSP_VIC
    select LOSCFG_CSKY_SYSTICK
    select LOSCFG_DRIVERS_UART_CSKY_PORT
    select LOSCFG_DRIVER_CSKY_LIB
    select LOSCFG_USING_BOARD_LD

config LOSCFG_PLATFORM_ESP32_QEMU
    bool "ESP32"
    select LOSCFG_USING_BOARD_LD
    select LOSCFG_ARCH_XTENSA_LX6
    select LOSCFG_XTENSA_LX6_TIMER
    select LOSCFG_LX6_INT_CONTROLLER

endchoice
```

## src/targets/Kconfig.raspberry
```kconfig
config LOSCFG_PLATFORM
    string
    default "Raspberry_Pi2B"      if LOSCFG_PLATFORM_RASPBERRY_PI2B
    default "Raspberry32_Pi3B"    if LOSCFG_PLATFORM_RASPBERRY32_PI3B
    default "Raspberry64_Pi3B"    if LOSCFG_PLATFORM_RASPBERRY64_PI3B
    default "Raspberry_Pi4B"      if LOSCFG_PLATFORM_RASPBERRY_PI4B

choice
    prompt "Target"
    depends on LOSCFG_FAMILY_RASPBERRY
    default LOSCFG_PLATFORM_RASPBERRY_PI2B
    help
      Raspberry Pi2B
      Raspberry32 Pi3B
      Raspberry_Pi4B

config LOSCFG_PLATFORM_RASPBERRY_PI2B
    bool "Raspberry_Pi2B"
    select LOSCFG_ARCH_CORTEX_A7
    select LOSCFG_USING_BOARD_LD
    select LOSCFG_PLATFORM_ARM_CONTROL
    select LOSCFG_RASPBERRY_PI_SYSTICK
    select LOSCFG_DRIVER_HAL_LIB

config LOSCFG_PLATFORM_RASPBERRY32_PI3B
    bool "Raspberry32_Pi3B"
    select LOSCFG_ARCH_CORTEX_A53_AARCH32
    select LOSCFG_USING_BOARD_LD
    select LOSCFG_PLATFORM_ARM_CONTROL
    select LOSCFG_RASPBERRY_PI_SYSTICK

config LOSCFG_PLATFORM_RASPBERRY_PI4B
    bool "Raspberry_Pi4B"
    select LOSCFG_ARCH_CORTEX_A72
    select LOSCFG_USING_BOARD_LD
    select LOSCFG_ARM_GIC_V2
    select LOSCFG_ARM_GENERIC_TIMER
    select LOSCFG_ARCH_ARM_AARCH64

config LOSCFG_PLATFORM_RASPBERRY64_PI3B
    bool "Raspberry64_Pi3B"
    select LOSCFG_ARCH_CORTEX_A53
    select LOSCFG_USING_BOARD_LD
    select LOSCFG_PLATFORM_ARM_CONTROL
    select LOSCFG_RASPBERRY_PI_SYSTICK
    select LOSCFG_ARCH_ARM_AARCH64

endchoice
```

## src/targets/Kconfig.sifive
```kconfig
config LOSCFG_PLATFORM
    string
    default "HiFive1_Rev1_B01"          if LOSCFG_PLATFORM_HIFIVE1_REV1_B01

choice
    prompt "Target"
    depends on LOSCFG_FAMILY_SIFIVE
    default LOSCFG_PLATFORM_HIFIVE1_REV1_B01
    help
      HiFive1_Rev1_B01

config LOSCFG_PLATFORM_HIFIVE1_REV1_B01
    bool "HiFive1_Rev1_B01"
    select LOSCFG_ARCH_RISCV_RV32IMC
    select LOSCFG_DRIVER_SIFIVE_LIB
    select LOSCFG_USING_BOARD_LD
    select LOSCFG_RISCV32_M_TIMER
    select LOSCFG_PLATFORM_BSP_RISCV_PLIC

endchoice
```
