## src/targets/Kconfig.stm32
```kconfig
config LOSCFG_PLATFORM
    string
    default "Cloud_STM32F429IGTx_FIRE"  if LOSCFG_PLATFORM_STM32F429IGTX
    default "STM32F072_Nucleo"          if LOSCFG_PLATFORM_STM32F072_Nucleo
    default "STM32F103_FIRE_Arbitrary"  if LOSCFG_PLATFORM_STM32F103_FIRE_ARBITRARY
    default "STM32F103_C8T6"            if LOSCFG_PLATFORM_STM32F103_C8T6
    default "STM32F407_ATK_Explorer"    if LOSCFG_PLATFORM_STM32F407_ATK_EXPLORER
    default "STM32F769IDISCOVERY"       if LOSCFG_PLATFORM_STM32F769IDISCOVERY
    default "STM32F746_Nucleo"          if LOSCFG_PLATFORM_STM32F746_NUCLEO
    default "STM32L4R9I_Discovery"      if LOSCFG_PLATFORM_STM32L4R9I_DISCOVERY
    default "STM32L073_Nucleo"          if LOSCFG_PLATFORM_STM32L073_NUCLEO
    default "STM32L431_BearPi"          if LOSCFG_PLATFORM_STM32L431_BearPi
    default "STM32L496_Nucleo"          if LOSCFG_PLATFORM_STM32L496_NUCLEO
    default "STM32L476_NB476"           if LOSCFG_PLATFORM_STM32L476_NB476
    default "STM32L552_Nucleo"          if LOSCFG_PLATFORM_STM32L552_NUCLEO
    default "STM32F767_Nucleo"          if LOSCFG_PLATFORM_STM32F767_NUCLEO

choice
    prompt "Target"
    depends on LOSCFG_FAMILY_STM32
    default LOSCFG_PLATFORM_STM32F429IGTX
    help
      support several boards:
      Cloud_STM32F429IGTx_FIRE
      STM32F072_Nucleo
      STM32F103_FIRE_Arbitrary
      STM32F103_C8T6
      STM32F407_ATK_Explorer
      STM32F769IDISCOVERY
      STM32F746_Nucleo
      STM32L4R9I_Discovery
      STM32L073_Nucleo
      STM32L431_BearPi
      STM32L476_NB476
      STM32L496_Nucleo
      STM32L552_Nucleo
      STM32F767_Nucleo

config LOSCFG_PLATFORM_STM32F767_NUCLEO
    bool "STM32F767_Nucleo"
    select LOSCFG_ARCH_CORTEX_M7
    select LOSCFG_CORTEX_M_NVIC
    select LOSCFG_CORTEX_M_SYSTICK
    select LOSCFG_HW_SD_CARD
    select LOSCFG_DRIVER_HAL_LIB
    select LOSCFG_USING_BOARD_LD

config LOSCFG_PLATFORM_STM32F429IGTX
    bool "Cloud_STM32F429IGTx_FIRE"
    select LOSCFG_USING_BOARD_LD
    select LOSCFG_ARCH_CORTEX_M4
    select LOSCFG_CORTEX_M_NVIC
    select LOSCFG_CORTEX_M_SYSTICK
    select LOSCFG_HW_SD_CARD
    select LOSCFG_HW_SPI_FLASH
    select LOSCFG_DRIVER_HAL_LIB

choice
    prompt "Choose Hardware Board Version"
    default LOSCFG_HW_BOARD_V2
    depends on LOSCFG_PLATFORM_STM32F429IGTX
    config LOSCFG_HW_BOARD_V1
        bool "Hw Board V1"
        depends on LOSCFG_PLATFORM_STM32F429IGTX

    config LOSCFG_HW_BOARD_V2
        bool "Hw Board V2"
        depends on LOSCFG_PLATFORM_STM32F429IGTX
endchoice

config LOSCFG_PLATFORM_STM32F072_Nucleo
    bool "STM32F072_Nucleo"
    select LOSCFG_USING_BOARD_LD
    select LOSCFG_ARCH_CORTEX_M0
    select LOSCFG_CORTEX_M_NVIC
    select LOSCFG_CORTEX_M_SYSTICK
    select LOSCFG_DRIVER_HAL_LIB

config LOSCFG_PLATFORM_STM32F103_FIRE_ARBITRARY
    bool "STM32F103_FIRE_Arbitrary"
    select LOSCFG_USING_BOARD_LD
    select LOSCFG_ARCH_CORTEX_M3
    select LOSCFG_CORTEX_M_NVIC
    select LOSCFG_CORTEX_M_SYSTICK
    select LOSCFG_DRIVER_HAL_LIB

config LOSCFG_PLATFORM_STM32F103_C8T6
    bool "STM32F103_C8T6"
    select LOSCFG_USING_BOARD_LD
    select LOSCFG_ARCH_CORTEX_M3
    select LOSCFG_CORTEX_M_NVIC
    select LOSCFG_CORTEX_M_SYSTICK
    select LOSCFG_DRIVER_HAL_LIB

config LOSCFG_PLATFORM_STM32F407_ATK_EXPLORER
    bool "STM32F407_ATK_Explorer"
    select LOSCFG_USING_BOARD_LD
    select LOSCFG_ARCH_CORTEX_M4
    select LOSCFG_CORTEX_M_NVIC
    select LOSCFG_CORTEX_M_SYSTICK
    select LOSCFG_DRIVER_HAL_LIB

config LOSCFG_PLATFORM_STM32F769IDISCOVERY
    bool "STM32F769IDISCOVERY"
    select LOSCFG_ARCH_CORTEX_M7
    select LOSCFG_CORTEX_M_NVIC
    select LOSCFG_CORTEX_M_SYSTICK
    select LOSCFG_HW_SD_CARD
    select LOSCFG_DRIVER_HAL_LIB
    select LOSCFG_USING_BOARD_LD

config LOSCFG_PLATFORM_STM32F746_NUCLEO
    bool "STM32F746_Nucleo"
    select LOSCFG_ARCH_CORTEX_M7
    select LOSCFG_CORTEX_M_NVIC
    select LOSCFG_CORTEX_M_SYSTICK
    select LOSCFG_DRIVER_HAL_LIB
    select LOSCFG_USING_BOARD_LD

config LOSCFG_PLATFORM_STM32L4R9I_DISCOVERY
    bool "STM32L4R9I_Discovery"
    select LOSCFG_USING_BOARD_LD
    select LOSCFG_ARCH_CORTEX_M4
    select LOSCFG_CORTEX_M_NVIC
    select LOSCFG_CORTEX_M_SYSTICK
    select LOSCFG_DRIVER_HAL_LIB

config LOSCFG_PLATFORM_STM32L073_NUCLEO
    bool "STM32L073_Nucleo"
    select LOSCFG_USING_BOARD_LD
    select LOSCFG_ARCH_CORTEX_M0_PLUS
    select LOSCFG_CORTEX_M_NVIC
    select LOSCFG_CORTEX_M_SYSTICK
    select LOSCFG_DRIVER_HAL_LIB

config LOSCFG_PLATFORM_STM32L431_BearPi
    bool "STM32L431_BearPi"
    select LOSCFG_USING_BOARD_LD
    select LOSCFG_ARCH_CORTEX_M4
    select LOSCFG_CORTEX_M_NVIC
    select LOSCFG_CORTEX_M_SYSTICK
    select LOSCFG_DRIVER_HAL_LIB
    select LOSCFG_DRIVER_E53
    select LOSCFG_HW_SPI_FLASH

config LOSCFG_PLATFORM_STM32L476_NB476
    bool "STM32L476_NB476"
    select LOSCFG_USING_BOARD_LD
    select LOSCFG_ARCH_CORTEX_M4
    select LOSCFG_CORTEX_M_NVIC
    select LOSCFG_CORTEX_M_SYSTICK
    select LOSCFG_DRIVER_HAL_LIB

config LOSCFG_PLATFORM_STM32L496_NUCLEO
    bool "STM32L496_Nucleo"
    select LOSCFG_USING_BOARD_LD
    select LOSCFG_ARCH_CORTEX_M4
    select LOSCFG_CORTEX_M_NVIC
    select LOSCFG_CORTEX_M_SYSTICK
    select LOSCFG_DRIVER_HAL_LIB

config LOSCFG_PLATFORM_STM32L552_NUCLEO
    bool "STM32L552_Nucleo"
    select LOSCFG_USING_BOARD_LD
    select LOSCFG_ARCH_CORTEX_M33
    select LOSCFG_CORTEX_M_NVIC
    select LOSCFG_CORTEX_M_SYSTICK
    select LOSCFG_DRIVER_HAL_LIB

endchoice
```

## src/targets/Kconfig.xtensa
```kconfig
config LOSCFG_PLATFORM
    string
    default "ESP32"      if LOSCFG_PLATFORM_ESP32
    default "ESP8266"    if LOSCFG_PLATFORM_ESP8266

config LOSCFG_XTENSA_WINDOWSPILL
    bool "Enable Window Spill"
    default y
    depends on LOSCFG_ARCH_XTENSA_LX6
    help
        XTENSA window spill

config LOSCFG_XTENSA_LOOPS
    bool "Enable Xtensa Loops"
    default y
    depends on LOSCFG_ARCH_XTENSA_LX6
    help
        XTENSA loop

choice
    prompt "Board"
    depends on LOSCFG_FAMILY_XTENSA
    default LOSCFG_PLATFORM_ESP32
    help
      ESP32
      ESP8266

config LOSCFG_PLATFORM_ESP32
    bool "ESP32"
    select LOSCFG_USING_BOARD_LD
    select LOSCFG_ARCH_XTENSA_LX6
    select LOSCFG_XTENSA_LX6_TIMER
    select LOSCFG_LX6_INT_CONTROLLER

config LOSCFG_PLATFORM_ESP8266
    bool "ESP8266"
    select LOSCFG_USING_BOARD_LD
    select LOSCFG_ARCH_XTENSA_L106
    select LOSCFG_XTENSA_LX6_TIMER
    select LOSCFG_LX6_INT_CONTROLLER

endchoice
```

## src/test/Kconfig
```kconfig
menu "Test Basic Config"

depends on LOSCFG_TEST

config LOSCFG_TEST_MODULE_CHECK
    bool "Enable module test suite result check"
    default y
    depends on LOSCFG_TEST

config LOSCFG_TEST_TASK_STACK_SIZE
    hex "Test Task Stack Size"
    default 0x3000
    help
      This represents the test task stack size.

config LOSCFG_TEST_PLATFORM_MEMPOOL_SIZE
    hex "Test Platform Mempool Size"
    default 0x5000
    help
      This represents the test platform mempool size.

endmenu

config LOSCFG_TEST_KERNEL_BASE
    bool "Enable Kernel Testsuit"
    default y
    depends on LOSCFG_TEST
config LOSCFG_TEST_KERNEL_BASE_TASK
    bool "Enable Task Testsuit"
    default y
    depends on LOSCFG_TEST_KERNEL_BASE && LOSCFG_TEST
config LOSCFG_TEST_KERNEL_BASE_HWI
    bool "Enable Hwi Testsuit"
    default y
    depends on LOSCFG_TEST_KERNEL_BASE && LOSCFG_TEST
config LOSCFG_TEST_KERNEL_BASE_SWTMR
    bool "Enable Swtmr Testsuit"
    default y
    depends on LOSCFG_TEST_KERNEL_BASE && LOSCFG_TEST && LOSCFG_BASE_CORE_SWTMR
config LOSCFG_TEST_KERNEL_BASE_IPC_QUEUE
    bool "Enable Queue Testsuit"
    default y
    depends on LOSCFG_TEST_KERNEL_BASE && LOSCFG_TEST && LOSCFG_BASE_IPC_QUEUE
config LOSCFG_TEST_KERNEL_BASE_IPC_MUX
    bool "Enable MUX Testsuit"
    default y
    depends on LOSCFG_TEST_KERNEL_BASE && LOSCFG_TEST && LOSCFG_BASE_IPC_MUX
config LOSCFG_TEST_KERNEL_BASE_IPC_SEM
    bool "Enable Sem Testsuit"
    default y
    depends on LOSCFG_TEST_KERNEL_BASE && LOSCFG_TEST && LOSCFG_BASE_IPC_SEM
config LOSCFG_TEST_KERNEL_BASE_IPC_EVENT
    bool "Enable Event Testsuit"
    default y
    depends on LOSCFG_TEST_KERNEL_BASE && LOSCFG_TEST && LOSCFG_BASE_IPC_EVENT
config LOSCFG_TEST_KERNEL_BASE_MP
    bool "Enable MP Testsuit"
    default y
    depends on LOSCFG_TEST_KERNEL_BASE && LOSCFG_TEST && LOSCFG_KERNEL_SMP
config LOSCFG_TEST_KERNEL_BASE_MEM
    bool "Enable MEM Testsuit"
    default y
    depends on LOSCFG_TEST_KERNEL_BASE && LOSCFG_TEST
config LOSCFG_TEST_KERNEL_BASE_MISC
    bool "Enable MISC Testsuit"
    default y
    depends on LOSCFG_TEST_KERNEL_BASE && LOSCFG_TEST
config LOSCFG_TEST_KERNEL_BASE_ATOMIC
    bool "Enable ATOMIC Testsuit"
    default y
    depends on LOSCFG_TEST_KERNEL_BASE && LOSCFG_TEST
```
