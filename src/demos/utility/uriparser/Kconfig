## src/tools/menuconfig/config.in
```kconfig
#
# For a description of the syntax of this configuration file,
# see extra/config/Kconfig-language.txt
#
mainmenu "Huawei LiteOS Configuration"

menu "Compiler"

config LOSCFG_COMPILER_GCC
    bool
    help
      This option means this is GNU Compiler Collection (GCC) compiler,
      or work based on GCC.

config LOSCFG_COMPILER_CLANG
    bool
    help
      This option means this is Clang/Low Level Virtual Machine (LLVM) compiler,
      or work based on Clang/LLVM.

choice
    prompt "Compiler"
    default LOSCFG_COMPILER_ARM_NONE_EABI
    help
      Enable arm-none-eabi compiler.

config LOSCFG_COMPILER_HIMIX_32
    bool "arm-himix410-linux"
    depends on LOSCFG_ARCH_ARM_AARCH32
    select LOSCFG_COMPILER_GCC

config LOSCFG_COMPILER_CSKYV2
    bool "csky-elfabiv2"
    depends on LOSCFG_ARCH_CSKY_V2
    select LOSCFG_COMPILER_GCC

config LOSCFG_COMPILER_HIMIX100_64
    bool "aarch64-himix100-linux"
    depends on LOSCFG_ARCH_ARM_AARCH64
    select LOSCFG_COMPILER_GCC

config LOSCFG_COMPILER_HCC_64
    bool "aarch64-hcc-linux"
    depends on LOSCFG_ARCH_ARM_AARCH64
    select LOSCFG_COMPILER_GCC

config LOSCFG_COMPILER_GCC_64
    bool "aarch64-none-elf"
    depends on LOSCFG_ARCH_ARM_AARCH64
    select LOSCFG_COMPILER_GCC

config LOSCFG_COMPILER_RISCV_NULEI
    bool "riscv-nuclei-elf"
    depends on LOSCFG_ARCH_RISCV_RV32IMC
    select LOSCFG_COMPILER_GCC

config LOSCFG_COMPILER_RISCV_UNKNOWN
    bool "riscv32-unknown-elf"
    depends on LOSCFG_ARCH_RISCV_RV32IMC
    select LOSCFG_COMPILER_GCC

config LOSCFG_COMPILER_RISCV64_UNKNOWN
    bool "riscv64-unknown-elf"
    depends on LOSCFG_ARCH_RISCV_RV32IMC
    select LOSCFG_COMPILER_GCC

config LOSCFG_COMPILER_XTENSA_32
    bool "xtensa-(RF~RI)-201x.x-linux"
    depends on LOSCFG_ARCH_XTENSA
    select LOSCFG_COMPILER_CLANG

config LOSCFG_COMPILER_ARM_NONE_EABI
    bool "arm-none-eabi-"
    depends on LOSCFG_ARCH_ARM_AARCH32
    select LOSCFG_COMPILER_GCC

config LOSCFG_COMPILER_XTENSA_LX6
    bool "xtensa-esp32-elf-"
    depends on LOSCFG_ARCH_XTENSA_ARCH32
    select LOSCFG_COMPILER_GCC

config LOSCFG_COMPILER_XTENSA_L106
    bool "xtensa-lx106-elf-"
    depends on LOSCFG_ARCH_XTENSA_ARCH32
    select LOSCFG_COMPILER_GCC

endchoice

menu "Compiler Options"
config LOSCFG_RISCV_COMPILER_OPTIONS_USER_DEFINED
    string "User-defined Compiler Options"
    default ""
    depends on LOSCFG_COMPILER_RISCV_UNKNOWN || LOSCFG_COMPILER_RISCV
    help
      You can input your own compiler options.

config LOSCFG_RISCV_COMPILER_OPTIONS_EMIT_LLI
    bool "Enable -femit-lli"
    default y
    depends on LOSCFG_COMPILER_RISCV_UNKNOWN || LOSCFG_COMPILER_RISCV
    help
      Please confirm that your compiler or board supports it.

config LOSCFG_RISCV_COMPILER_OPTIONS_LBU_SB
    bool "Enable -Wa,-enable-c-lbu-sb"
    default y
    depends on LOSCFG_COMPILER_RISCV_UNKNOWN
    help
      Please confirm that your compiler or board supports it.

config LOSCFG_RISCV_COMPILER_OPTIONS_NO_INLINE
    bool "Enable -fno-inline-small-functions"
    default n
    depends on LOSCFG_COMPILER_RISCV_UNKNOWN
    help
      This is usually used to patch for ROM codes easily.

choice
    prompt "Function Stack Save Mode"
    default LOSCFG_RISCV_COMPILER_OPTIONS_SAVE_RESTORE
    depends on (LOSCFG_COMPILER_RISCV_UNKNOWN || LOSCFG_COMPILER_RISCV) && !LOSCFG_BACKTRACE
    help
    This Option will choose compile option for riscv.
    Please confirm that your compiler or board supports it.

config LOSCFG_RISCV_COMPILER_OPTIONS_SAVE_RESTORE
    bool "Enable -msave-restore"
config LOSCFG_RISCV_COMPILER_OPTIONS_PUSH_POP
    bool "Enable -mpush-pop"
endchoice

endmenu

choice
    prompt "Optimize Option"
    default LOSCFG_COMPILER_OPTIMIZE_SPEED
    help
      This Option will enable compiler Optimize options.

config LOSCFG_COMPILER_OPTIMIZE_NONE
    bool "Optimize None"
config LOSCFG_COMPILER_OPTIMIZE_SPEED
    bool "Optimize Speed"
config LOSCFG_COMPILER_OPTIMIZE_SIZE
    bool "Optimize Size"
endchoice

endmenu

menu "Targets"

######################### config options of bsp #####################
source "targets/Kconfig"

######################### config options of cpu #####################
source "arch/Kconfig"

endmenu


######################### config options of kernel #####################
source "kernel/Kconfig"
######################### config options of lib ########################
source "lib/Kconfig"
######################### config options of compatibility ##############
osource "compat/Kconfig"
######################### config options of components ##############
source "components/Kconfig"
source "demos/Kconfig"
######################## config options of filesystem ##################
#osource "fs/Kconfig"

######################## config options of net ############################
#osource "net/Kconfig"

######################## config options of debug ########################
menu "Debug"
config LOSCFG_COMPILE_DEBUG
    bool "Enable GCC -g Option"
    default n

    help
      Answer Y to add -g option in gcc command. But the LiteOS size will be much larger.

config LOSCFG_PLATFORM_ADAPT
    bool "Enable Os_adapt"
    default y

    help
      Answer Y to add os_adapt.c to LiteOS.

#config LOSCFG_COREDUMP
#    bool "Enable Coredump"
#    default n
#
#    help
#      Answer Y to enable Coredump for LiteOS.
#
#config COREDUMP_COMPRESS_MEM_SIZE
#    int "set the compress-packet size(K)"
#    default 64
#    depends on LOSCFG_COREDUMP
#    help
#      Its uint is K and the default size is 64K(Raise the size of compressing the packet of dumpinfo to reduce the time of using,if you have enough memory space.)

config LOSCFG_BACKTRACE
    bool "Enable Backtrace"
    default y
    help
      Answer Y to enable backtrace for LiteOS.

#config LOSCFG_GDB
#    bool "Enable GDB"
#    default n
#
#choice
#    prompt "GDB Debug"
#    depends on LOSCFG_GDB
#    default  LOSCFG_GDB_DEBUG
#    help
#        LOSCFG_GDB_DEBUG
#        LOSCFG_GDB_ABNORMAL
#
#config LOSCFG_GDB_DEBUG
#    bool "GDB adds breakpoint to debug code"
#
#config LOSCFG_GDB_ABNORMAL
#    bool "When it's abnormal , invoking gdb to check backtrace"
#
#endchoice

config LOSCFG_DO_ALIGN
    bool "Enable do align for hi3518e"
    default y
    depends on LOSCFG_PLATFORM_HI3518EV200
    help
      Answer Y to enable do align for hi3518e.

config LOSCFG_ENABLE_MAGICKEY
    bool "Enable MAGIC KEY"
    default y
    depends on LOSCFG_SHELL
    help
      Answer Y to enable LiteOS Magic key.
        ctrl + r : Magic key check switch;
        ctrl + z : Show all magic op key;
        ctrl + t : Show task information;
        ctrl + p : System panic;
        ctrl + e : Check system memory pool.

config LOSCFG_THUMB
    bool "Enable Thumb"
    default n

    help
      Answer Y to build thumb version.  This will make LiteOS smaller.
config LOSCFG_PLATFORM_DVFS
    bool "Enable Dvfs"
    default n
    depends on  LOSCFG_COMPAT_LINUX
    help
      Answer Y to enable LiteOS support dynamic voltage and frequency scaling feature for
      low power consumption.

config LOSCFG_DEBUG_VERSION
    bool "Enable a Debug Version"
    default n

    help
      If you do not select this option that means you enable a release version for LiteOS.
      It also means you do not want to use debug modules, like shell,telnet,tftp,
      ,nfs,ramfs proc and memory check.
      If you select this option that means you enable a debug version for LiteOS.
      That means you want a opposite behaviour compared to release version.

config LOSCFG_DEBUG_KERNEL
    bool "Enable Debug LiteOS Kernel Resource"
    default n
    depends on LOSCFG_DEBUG_VERSION
    help
      If you select this option that means you enable debugging kernel resource.
      It also means you want to get queue, mutex, semaphore, memory debug information.
      That means you want a opposite behaviour compared to release version.

config LOSCFG_DEBUG_QUEUE
    bool "Enable Queue Debugging"
    default n
    depends on LOSCFG_DEBUG_KERNEL && LOSCFG_BASE_IPC_QUEUE
    help
      Answer Y to enable debug queue.

config LOSCFG_DEBUG_MUTEX
    bool "Enable Mutex Debugging"
    default n
    depends on LOSCFG_DEBUG_KERNEL && LOSCFG_BASE_IPC_MUX
    help
      Answer Y to enable debug mutex.

config LOSCFG_DEBUG_MUTEX_DEADLOCK
    bool "Enable Mutex Deadlock Debugging"
    default n
    depends on LOSCFG_DEBUG_KERNEL && LOSCFG_BASE_IPC_MUX
    help
      Answer Y to enable debug mutex deadlock.

config LOSCFG_DEBUG_SEMAPHORE
    bool "Enable Semaphore Debugging"
    default n
    depends on LOSCFG_DEBUG_KERNEL && LOSCFG_BASE_IPC_SEM
    help
      Answer Y to enable debug semaphore.

config LOSCFG_DEBUG_SCHED_STATISTICS
    bool "Enable Scheduler Statistics Debugging"
    depends on LOSCFG_DEBUG_KERNEL
    default n
    help
      Answer Y to enable debug schedulder statistics.

osource "shell/Kconfig"
config LOSCFG_NET_LWIP_SACK_TFTP
    bool "Enable Tftp"
    default y
    depends on LOSCFG_SHELL && LOSCFG_NET_LWIP_SACK && LOSCFG_DEBUG_VERSION
    help
      Answer Y to enable LiteOS support tftp cmd and tftp tool.

#osource "net/telnet/Kconfig"
config LOSCFG_EXC_INTERACTION
    bool "Enable exc interaction"
    default n
    depends on LOSCFG_SHELL && LOSCFG_KERNEL_CONSOLE
    help
      Answer Y to enable exception interaction for LiteOS, when the system enter exception, user can also interact with system by shell
      command like readreg, writereg,task,hwi.

config LOSCFG_USB_DEBUG
    bool "Enable USB Debug"
    default n
    depends on LOSCFG_SHELL && LOSCFG_DRIVERS_USB && LOSCFG_DEBUG_VERSION
    help
      Answer Y to enable LiteOS support usb debug.
      use shell command to open the specified debug level print.

config LOSCFG_MEM_DEBUG
    bool "Enable MEM Debug"
    default n
    depends on LOSCFG_DEBUG_VERSION
    help
      Answer Y to enable LiteOS support mem debug.

config LOSCFG_MEM_MUL_MODULE
    bool "Enable Memory module statistics"
    default n
    depends on LOSCFG_MEM_DEBUG && LOSCFG_KERNEL_MEM_BESTFIT
    help
      Answer Y to enable LiteOS support memory statistics depend on different module

config LOSCFG_MEM_MUL_POOL
    bool "Enable Memory multi-pool control"
    default y
    depends on LOSCFG_MEM_DEBUG && (LOSCFG_KERNEL_MEM_BESTFIT || LOSCFG_KERNEL_MEM_BESTFIT_LITTLE)
    help
      Answer Y to enable LiteOS support memory multi-pool control

config LOSCFG_TASK_STACK_PROTECT
    bool "Enable Stack protect by mmu"
    default y
    depends on LOSCFG_DEBUG_VERSION && LOSCFG_PLATFORM_HI3731 && LOSCFG_MEM_DEBUG
    help
      Answer Y to enable Stack protect use mmu

config LOSCFG_MEM_HEAD_BACKUP
    bool "Enable Node Head Backup"
    default n
    depends on LOSCFG_MEM_DEBUG && LOSCFG_KERNEL_MEM_BESTFIT
    help
      Answer Y to enable node head backup

config LOSCFG_MEM_LEAKCHECK
    bool "Enable Function call stack of Mem operation recorded"
    default n
    depends on LOSCFG_MEM_DEBUG && LOSCFG_KERNEL_MEM_BESTFIT
    depends on !LOSCFG_ARCH_ARM_CORTEX_M && !LOSCFG_COMPILER_XTENSA_32
    select LOSCFG_BACKTRACE
    help
      Answer Y to enable record the LR of Function call stack of Mem operation, it can check the mem leak through the infomations of mem node.

config LOSCFG_BASE_MEM_NODE_INTEGRITY_CHECK
    bool "Enable integrity check or not"
    default n
    depends on LOSCFG_MEM_DEBUG && (LOSCFG_KERNEL_MEM_BESTFIT || LOSCFG_KERNEL_MEM_BESTFIT_LITTLE)

config LOSCFG_BASE_MEM_NODE_SIZE_CHECK
    bool "Enable size check or not"
    default n
    depends on LOSCFG_MEM_DEBUG && LOSCFG_KERNEL_MEM_BESTFIT

config LOSCFG_SLAB_INFO_STATISTIC
    bool "Enable SLAB Statistic"
    default n
    depends on  LOSCFG_DEBUG_VERSION && LOSCFG_KERNEL_MEM_SLAB && LOSCFG_MEM_DEBUG

config LOSCFG_NULL_ADDRESS_PROTECT
    bool "Enable NULL Address protect"
    default n
    depends on (LOSCFG_PLATFORM_HI3518EV200 || LOSCFG_PLATFORM_HI3516CV300) && LOSCFG_DEBUG_VERSION
    help
      Answer Y to set mem address 0~1M prohibit to access, read or write will trigger exception.

config LOSCFG_SERIAL_OUTPUT_ENABLE
    bool "Enable Serial Output"
    default y
    help
      Answer Y to enable LiteOS serial output, otherwise disable LiteOS serial output.

menu "TestSuite or AppInit"
choice
    prompt "Enable TestSuite or AppInit"
    default  LOSCFG_PLATFORM_OSAPPINIT

    help
      Enable osAppinit or testsuit for LiteOS.
config LOSCFG_PLATFORM_OSAPPINIT
    bool "Enable Appinit"

if LOSCFG_PLATFORM_STM32F429IGTX || LOSCFG_PLATFORM_STM32F769IDISCOVERY
config LOSCFG_TEST
    bool "Enable Auto TestSuit"
endif

endchoice
osource "test/Kconfig"
endmenu

osource "kernel/extended/lms/Kconfig"

endmenu

######################## config options os drivers ########################
source "drivers/Kconfig"

menu "Stack Smashing Protector (SSP) Compiler Feature"

choice
    prompt "Enable stack buffer overflow detection"
    default  LOSCFG_CC_STACKPROTECTOR_STRONG

    --help---
    This option turns on the -fstack-protector GCC feature. This
    feature puts, at the beginning of functions, a canary value on
    the stack just before the return address, and validates
    the value just before actually returning.  Stack based buffer
    overflows (that need to overwrite this return address) now also
    overwrite the canary, which gets detected and the attack is then
    neutralized via a kernel panic.

    This feature requires gcc version 4.2 or above, or a distribution
    gcc with the feature backported. Older versions are automatically
    detected and for those versions, this configuration option is
    ignored. (and a warning is printed during bootup)

config LOSCFG_CC_NO_STACKPROTECTOR
    bool "-fno-stack-protector"


config LOSCFG_CC_STACKPROTECTOR
    bool "-fstack-protector"

config LOSCFG_CC_STACKPROTECTOR_STRONG
    bool "-fstack-protector-strong"

config LOSCFG_CC_STACKPROTECTOR_ALL
    bool "-fstack-protector-all"


endchoice

endmenu
```
